## Kconfig
```kconfig
#
# Copyright 2014, NICTA
#
# This software may be distributed and modified according to the terms of
# the BSD 2-Clause license. Note that NO WARRANTY is provided.
# See "LICENSE_BSD2.txt" for details.
#
# @TAG(NICTA_BSD)
#

# This options are imported into the top-level project of all projects.
menu "Toolchain Options"
    config CROSS_COMPILER_PREFIX
        string "Cross compiler prefix"
    default "arm-none-eabi-" if ARCH_ARM
    default "i686-pc-linux-gnu-" if ARCH_I386
    default ""
        help
            Set the cross compiler prefix, like arm-linux-gnueabi-
            Ensure the compiler is in your PATH or include the full
            path of the compiler in the prefix, such as
            /opt/toolchains/gcc4/arm-linux-gnueabi-

    config KERNEL_COMPILER
        string "Path to a different compiler to use for the kernel"
    default ""
        help
            If you set this option to a non-empty string, this compiler will be
            used for compiling the kernel. The compiler specified by your
            cross-compiler prefix will still be used for user-space. Note that
            this option does not affect the pre-processor, assembler or linker
            used on the kernel.

    config KERNEL_CFLAGS
        string "Compiler flags to use for compiling the kernel"
    default ""
        help
            Setting this option to a non-empty string overrides the default
            flags (and those you have selected elsewhere in the build
            configuration) that are passed to the compiler when compiling the
            kernel. This does not affect the compiler flags passed when
            compiling user-space.

            Use this option with care as it will prevent several sane default
            options that are normally passed. Note that this does not prevent
            DEFINES being passed to the compiler. This causes the pre-processor
            invocations in the kernel to assume they are targetting a non-GNU
            compiler. It does not affect the assembling or linking of the
            kernel.

    config KERNEL_EXTRA_CPPFLAGS
        string "Extra CPP flags to use for compiling the kernel"
        default ""
        help
            These flags will be appended to the C pre-processor flags used when
            compiling the kernel. Note these will not be applied during
            user-space pre-processing.

    config USER_DEBUG_INFO
        bool "Emit debugging information"
        default n
        help
            Emit debugging information when compiling applications and
            libraries. This does not affect the compiler flags applied to the
            kernel.

    config USER_EXTRA_CFLAGS
        string "Extra userspace CFLAGS"
        default ""
        depends on USER_CFLAGS = ""
        help
            Extra flags to append when compiling applications and libraries.
            This does not affect the flags applied when compiling the kernel.

    config USER_CFLAGS
        string "Override userspace CFLAGS"
        default ""
        help
            A set of flags to be used as the ONLY options when compiling
            applications and libraries. This does not affect the flags applied
            when compiling the kernel. This option takes precedence over "Extra
            userspace CFLAGS" and should be used with care.

    config BUILDSYS_USE_CCACHE
        bool "Use ccache to improve build performance"
        default y
        help
            ccache will cache object files based on compiler name, compile flags
            and source file name. On the next attempt to compile this file with
            the same compiler and flags, the object file will be copied from the
            cache rather than compiling from source.

    choice
        prompt "User compiler optimisation flag"
        depends on USER_CFLAGS = ""
        default USER_OPTIMISATION_O2
        help
            Select the compiler optimisation level for building user space

        config USER_OPTIMISATION_Os
            bool "-Os"
            help
                Compiler optimisations tuned for size

        config USER_OPTIMISATION_O0
            bool "-O0"
            help
                No optimisation

        config USER_OPTIMISATION_O1
            bool "-O1"
            help
                Basic compiler optimisations

        config USER_OPTIMISATION_O2
            bool "-O2"
            help
                Aggressive compiler optimisations

        config USER_OPTIMISATION_O3
            bool "-O3"
            help
                Enable all optimisations (may increase code size)
    endchoice

    config LINK_TIME_OPTIMISATIONS
        bool "Enable link time optimisations"
        default n
        depends on USER_CFLAGS = ""
        help
            Link time optimisations allow optimisations to be performed at link time
            enabling cross file optimisations to happen. Support for this may not exist
            in your compiler, and even if there is your build may explode.
            Consider this feature experimental!

    config WHOLE_PROGRAM_OPTIMISATIONS_USER
        bool "Link user assuming whole program"
        default n
        help
            Enable -fwhole-program when performing link step. This may be buggy if your build
            involves linking at times when -fwhole-program would not be correct to give. This
            will cause -fwhole-program to be passed when linking user elf images
            Consider this feature experimental!

    config WHOLE_PROGRAM_OPTIMISATIONS_KERNEL
        bool "Link kernel assuming whole program"
        default n
        help
            Enable -fwhole-program when linking kernel. This should work modulo gcc bugs, which
            are not uncommon with -fwhole-program
            Consider this feature experimental!

    config USER_DEBUG_BUILD
        bool "build user level with assertions, -g and debugging messages"
        default y if DEBUG_BUILD
        help
            Build user level as a debugging environment. If this option is off,
            NDEBUG is passed to Musl C which will turn off assertions. This will
            enable -g for user level.

    config BUILDSYS_CPP_SEPARATE
        bool "Separately invoke CPP"
        default n
        help
            Invoke the pre-processor in a separate step and produce an
            intermediate .c_pp file. This is relevant if you are wanting to
            verify C code or debug the pre-processor output.

    config BUILDSYS_CPP_RETAIN_COMMENTS
        bool "CPP: retain comments"
        default y
        depends on BUILDSYS_CPP_SEPARATE
        help
            Retain comments after pre-processing C code. This can be useful
            when the comments contain directives to the verification C parser.

    config BUILDSYS_CPP_LINE_DIRECTIVES
        bool "CPP: Emit line directives"
        default y
        depends on BUILDSYS_CPP_SEPARATE
        help
            Emit line directives in pre-processed C code. This allows your
            compiler to give you error messages indicating the source
            locations in original files. You might wish to switch this off if
            your pre-processed C file is then being used as an input to another
            process for which original source locations are no longer
            meaningful, or when your final compiler does not understand line
            directives.

endmenu
```

## elfloader-tool/Kconfig
```kconfig
#
# Copyright 2017, Data61
# Commonwealth Scientific and Industrial Research Organisation (CSIRO)
# ABN 41 687 119 230.
#
# This software may be distributed and modified according to the terms of
# the GNU General Public License version 2. Note that NO WARRANTY is provided.
# See "LICENSE_GPLv2.txt" for details.
#
# @TAG(DATA61_GPL)
#

menuconfig LIB_ELFLOADER
    bool "Build elfloader"
    default y
    depends on ARCH_ARM
    select LIB_CPIO

choice
    prompt "Boot image type"
    default IMAGE_ELF
    depends on LIB_ELFLOADER
    help
        Select ELF or EFI boot image type

    config IMAGE_BINARY
        bool "Binary Boot Image"
        help
            Generate binary boot image

    config IMAGE_ELF
        bool "ELF Boot Image"
        help
            Generate ELF boot image

    config IMAGE_EFI
        bool "EFI Boot Image"
        depends on ARCH_AARCH64
        help
            Generate EFI boot image
endchoice

choice
    prompt "seL4 mode"
    default ARM_MONITOR_MODE if PLAT_TK1
    default ARM_S_SUPERVISOR_MODE if PLAT_IMX6
    depends on PLAT_TK1 || PLAT_IMX6
    help
        Select the mode to load the seL4 kernel.

config ARM_NS_SUPERVISOR_MODE
    bool "Load the seL4 kernel in non-secure supervisor mode"
    help
        The default mode for seL4 is non-secure supervisor mode

config ARM_S_SUPERVISOR_MODE
    bool "Load the seL4 kernel in secure supervisor mode"
    depends on PLAT_IMX6
    help
       The default mode for seL4 on i.MX6 Sabre.

config ARM_MONITOR_MODE
    bool "Load the seL4 kernel in monitor mode"
    help
        The elfloader loads the seL4 kernel in monitor mode.

config ARM_HYPERVISOR_MODE
    bool "Load the seL4 kernel in hypervisor mode (NS)"
    depends on PLAT_TK1
    help
        The elfloader loads seL4 kernel in hypvisor mode.

endchoice

config REMOVE_SYMBOLS
    bool "Remove ELF symbols from the final image"
    default y
	depends on IMAGE_ELF
    help
       Remove ELF symbols from the final image.

menuconfig HASH_INSTRUCTIONS
	bool "Perform a SHA256/MD5 Hash of the of each elf file that the elfloader checks on load"
	default n
	depends on IMAGE_ELF
	help
		Hashes each elf file (kernel + application)

        config HASH_SHA
        bool "Perform an SHA256 Hash on each ELF File. If this option isn't selected, then an MD5 Hash will be performed"
        depends on HASH_INSTRUCTIONS
        default y
        help
            Perform an SHA256 Hash on each ELF File. If this option isn't selected, then an MD5 Hash will be performed

config ARM_MONITOR_HOOK
    bool "Install hooks in monitor mode"
    default n
    depends on PLAT_TK1 || PLAT_IMX6
    help
       Install SMC call handlers in monitor mode.

config GPT_PTIMER_NS_PL1_ACCESS
    bool "Enable GPT physical timer access for NS PL1"
    depends on ARM_NS_SUPERVISOR_MODE
    help
        Enalbe the GPT physical timer access for NS PL1

config ARM_ERRATA_764369
    bool "Workaround for ARM errata 764369"
    depends on LIB_ELFLOADER
    default y
    help
        Work around for a Cortex-A9 errata. Derived from Linux kernel.
```

## libcpio/Kconfig
```kconfig
#
# Copyright 2014, NICTA
#
# This software may be distributed and modified according to the terms of
# the BSD 2-Clause license. Note that NO WARRANTY is provided.
# See "LICENSE_BSD2.txt" for details.
#
# @TAG(NICTA_BSD)
#

config LIB_CPIO
    bool "libcpio"
    default y
    select HAVE_LIB_CPIO
    help
        Library for parsing ".cpio" file headers.

config HAVE_LIB_CPIO
    bool
```

## libelf/Kconfig
```kconfig
#
# Copyright 2017, Data61
# Commonwealth Scientific and Industrial Research Organisation (CSIRO)
# ABN 41 687 119 230.
#
# This software may be distributed and modified according to the terms of
# the BSD 2-Clause license. Note that NO WARRANTY is provided.
# See "LICENSE_BSD2.txt" for details.
#
# @TAG(DATA61_BSD)
#

config LIB_ELF
    bool "libelf"
    depends on HAVE_LIBC
    select HAVE_LIB_ELF
    default y
    help
        ELF parsing library

config HAVE_LIB_ELF
    bool
```

## libethdrivers/Kconfig
```kconfig
#
# Copyright 2017, Data61
# Commonwealth Scientific and Industrial Research Organisation (CSIRO)
# ABN 41 687 119 230.
#
# This software may be distributed and modified according to the terms of
# the GNU General Public License version 2. Note that NO WARRANTY is provided.
# See "LICENSE_GPLv2.txt" for details.
#
# @TAG(DATA61_GPL)
#

menuconfig LIB_ETHIF
    bool "Build ethernet interface library"
    depends on HAVE_LIBC && LIB_UTILS && LIB_PLATSUPPORT
    default y

config LIB_ETHDRIVER_RX_DESC_COUNT
    int "Number of RX descriptors"
    depends on LIB_ETHIF
    default 128
    help
        The number of RX descriptors in the descriptor ring for the
        driver.

config LIB_ETHDRIVER_TX_DESC_COUNT
    int "Number of TX descriptors"
    depends on LIB_ETHIF
    default 128
    help
        The number of TX descriptors in the descriptor ring for the
        driver.

config LIB_ETHDRIVER_NUM_PREALLOCATED_BUFFERS
    int "Number of preallocated DMA buffers"
    depends on LIB_ETHIF && (LIB_LWIP || LIB_PICOTCP)
    default 512
    help
        To avoid allocating and freeing buffers continuously the driver
        can preallocate a base amount internally.

config LIB_ETHDRIVER_PREALLOCATED_BUF_SIZE
    int "Size of preallocated DMA buffers"
    depends on LIB_ETHIF && (LIB_LWIP || LIB_PICOTCP)
    default 2048
    help
        The size of each preallocated buffer that will be used for RX and
        TX allocation requests. This needs to be the maximum of the RX buffer
        size and the MTU. Currently the largest RX buffer of any of the
        implemented drivers is 2048, and the MTU is 1500

config LIB_PICOTCP_ASYNC_DRIVER
    bool "Async driver for PicoTcp"
    depends on LIB_ETHIF && LIB_PICOTCP
    default y
    help
        Use an async instead of a polling driver for PicoTCP.
```

## libpci/Kconfig
```kconfig
#
# Copyright 2014, NICTA
#
# This software may be distributed and modified according to the terms of
# the BSD 2-Clause license. Note that NO WARRANTY is provided.
# See "LICENSE_BSD2.txt" for details.
#
# @TAG(NICTA_BSD)
#

config LIB_PCI
    bool "PCI support library"
    depends on LIB_SEL4 && HAVE_LIBC && LIB_PLATSUPPORT
    default y
    help
        Support library for x86 PCI.
```

## libpicotcp/Kconfig
```kconfig
#
# Copyright 2017, Data61
# Commonwealth Scientific and Industrial Research Organisation (CSIRO)
# ABN 41 687 119 230.
#
# This software may be distributed and modified according to the terms of
# the BSD 2-Clause license. Note that NO WARRANTY is provided.
# See "LICENSE_BSD2.txt" for details.
#
# @TAG(DATA61_BSD)
#

menuconfig LIB_PICOTCP
    bool "Build PicoTCP"
    default y
    help
        PicoTCP network stack library.

config LIB_PICOTCP_SOCKETS
    bool "Enable PicoTCP Sockets"
    default n
    depends on LIB_PICOTCP && LIB_SEL4_SYNC && LIB_SEL4_VKA
    help
        Whether to build PicoTCP sockets interface.
```

## libutils/Kconfig
```kconfig
#
# Copyright 2017, Data61
# Commonwealth Scientific and Industrial Research Organisation (CSIRO)
# ABN 41 687 119 230.
#
# This software may be distributed and modified according to the terms of
# the BSD 2-Clause license. Note that NO WARRANTY is provided.
# See "LICENSE_BSD2.txt" for details.
#
# @TAG(DATA61_BSD)
#

menuconfig LIB_UTILS
    bool "libutils"
    default y
    select HAVE_LIB_UTILS
    help
        OS independent util library

config LIB_UTILS_NO_STATIC_ASSERT
    bool "Disable _Static_assert"
    depends on LIB_UTILS
    default n
    help
        _Static_assert is provided in recent compilers as a way of testing a
        condition at compile-time. By default, this library detects whether
        _Static_assert is available and defines an analogue of it if not.
        Sometimes you want to force the latter behaviour if the tool consuming
        your C code does not understand _Static_assert (e.g. the verification
        C parser). This option forces the analogue to be used.

config LIB_UTILS_DEFAULT_ZF_LOG_LEVEL
    int "ZF_LOG default level"
    depends on LIB_UTILS
    default 5
    help
        Default ZF_LOG_LEVEL for the ZF_LOG library. 5 is LOG_LEVEL_ERROR. 0 is the
        most verbose setting.

config HAVE_LIB_UTILS
    bool
```
