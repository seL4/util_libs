/*
 * The code contained herein is licensed under the GNU General Public
 * License. You may obtain a copy of the GNU General Public License
 * Version 2 or later at the following locations:
 *
 * http://www.opensource.org/licenses/gpl-license.html
 * http://www.gnu.org/copyleft/gpl.html
 *
 * @TAG(OTHER_GPL)
 */

/dts-v1/;

/ {
	compatible = "hisilicon,hi6220-hikey", "hisilicon,hi6220";
	interrupt-parent = <0x1>;
	#address-cells = <0x2>;
	#size-cells = <0x2>;
	model = "HiKey Development Board";

	psci {
		compatible = "arm,psci-0.2";
		method = "smc";
	};

	cpus {
		#address-cells = <0x2>;
		#size-cells = <0x0>;

		cpu-map {

			cluster0 {

				core0 {
					cpu = <0x2>;
				};

				core1 {
					cpu = <0x3>;
				};

				core2 {
					cpu = <0x4>;
				};

				core3 {
					cpu = <0x5>;
				};
			};

			cluster1 {

				core0 {
					cpu = <0x6>;
				};

				core1 {
					cpu = <0x7>;
				};

				core2 {
					cpu = <0x8>;
				};

				core3 {
					cpu = <0x9>;
				};
			};
		};

		idle-states {
			entry-method = "psci";

			cpu-sleep {
				compatible = "arm,idle-state";
				local-timer-stop;
				arm,psci-suspend-param = <0x10000>;
				entry-latency-us = <0x2bc>;
				exit-latency-us = <0xfa>;
				min-residency-us = <0x3e8>;
				linux,phandle = <0xd>;
				phandle = <0xd>;
			};

			cluster-sleep {
				compatible = "arm,idle-state";
				local-timer-stop;
				arm,psci-suspend-param = <0x1010000>;
				entry-latency-us = <0x3e8>;
				exit-latency-us = <0x2bc>;
				min-residency-us = <0xa8c>;
				wakeup-latency-us = <0x5dc>;
				linux,phandle = <0xe>;
				phandle = <0xe>;
			};
		};

		cpu@0 {
			compatible = "arm,cortex-a53", "arm,armv8";
			device_type = "cpu";
			reg = <0x0 0x0>;
			enable-method = "psci";
			next-level-cache = <0xa>;
			clocks = <0xb 0x0>;
			operating-points-v2 = <0xc>;
			cooling-min-level = <0x4>;
			cooling-max-level = <0x0>;
			#cooling-cells = <0x2>;
			cpu-idle-states = <0xd 0xe>;
			sched-energy-costs = <0xf 0x10>;
			dynamic-power-coefficient = <0x137>;
			linux,phandle = <0x2>;
			phandle = <0x2>;
		};

		cpu@1 {
			compatible = "arm,cortex-a53", "arm,armv8";
			device_type = "cpu";
			reg = <0x0 0x1>;
			enable-method = "psci";
			next-level-cache = <0xa>;
			operating-points-v2 = <0xc>;
			cpu-idle-states = <0xd 0xe>;
			sched-energy-costs = <0xf 0x10>;
			linux,phandle = <0x3>;
			phandle = <0x3>;
		};

		cpu@2 {
			compatible = "arm,cortex-a53", "arm,armv8";
			device_type = "cpu";
			reg = <0x0 0x2>;
			enable-method = "psci";
			next-level-cache = <0xa>;
			operating-points-v2 = <0xc>;
			cpu-idle-states = <0xd 0xe>;
			sched-energy-costs = <0xf 0x10>;
			linux,phandle = <0x4>;
			phandle = <0x4>;
		};

		cpu@3 {
			compatible = "arm,cortex-a53", "arm,armv8";
			device_type = "cpu";
			reg = <0x0 0x3>;
			enable-method = "psci";
			next-level-cache = <0xa>;
			operating-points-v2 = <0xc>;
			cpu-idle-states = <0xd 0xe>;
			sched-energy-costs = <0xf 0x10>;
			linux,phandle = <0x5>;
			phandle = <0x5>;
		};

		cpu@100 {
			compatible = "arm,cortex-a53", "arm,armv8";
			device_type = "cpu";
			reg = <0x0 0x100>;
			enable-method = "psci";
			next-level-cache = <0x11>;
			operating-points-v2 = <0xc>;
			cpu-idle-states = <0xd 0xe>;
			sched-energy-costs = <0xf 0x10>;
			linux,phandle = <0x6>;
			phandle = <0x6>;
		};

		cpu@101 {
			compatible = "arm,cortex-a53", "arm,armv8";
			device_type = "cpu";
			reg = <0x0 0x101>;
			enable-method = "psci";
			next-level-cache = <0x11>;
			operating-points-v2 = <0xc>;
			cpu-idle-states = <0xd 0xe>;
			sched-energy-costs = <0xf 0x10>;
			linux,phandle = <0x7>;
			phandle = <0x7>;
		};

		cpu@102 {
			compatible = "arm,cortex-a53", "arm,armv8";
			device_type = "cpu";
			reg = <0x0 0x102>;
			enable-method = "psci";
			next-level-cache = <0x11>;
			operating-points-v2 = <0xc>;
			cpu-idle-states = <0xd 0xe>;
			sched-energy-costs = <0xf 0x10>;
			linux,phandle = <0x8>;
			phandle = <0x8>;
		};

		cpu@103 {
			compatible = "arm,cortex-a53", "arm,armv8";
			device_type = "cpu";
			reg = <0x0 0x103>;
			enable-method = "psci";
			next-level-cache = <0x11>;
			operating-points-v2 = <0xc>;
			cpu-idle-states = <0xd 0xe>;
			sched-energy-costs = <0xf 0x10>;
			linux,phandle = <0x9>;
			phandle = <0x9>;
		};

		l2-cache0 {
			compatible = "cache";
			linux,phandle = <0xa>;
			phandle = <0xa>;
		};

		l2-cache1 {
			compatible = "cache";
			linux,phandle = <0x11>;
			phandle = <0x11>;
		};

		energy-costs {

			core-cost {
				busy-cost-data = <0xb2 0x45 0x171 0x7c 0x26e 0xe0 0x333 0x16f 0x400 0x29e>;
				idle-cost-data = <0xf 0xf 0x0 0x0>;
				linux,phandle = <0xf>;
				phandle = <0xf>;
			};

			cluster-cost {
				busy-cost-data = <0xb2 0x10 0x171 0x1d 0x26e 0x2f 0x333 0x4b 0x400 0x70>;
				idle-cost-data = <0x2f 0x2f 0x2f 0x0>;
				linux,phandle = <0x10>;
				phandle = <0x10>;
			};
		};
	};

	cpu_opp_table {
		compatible = "operating-points-v2";
		opp-shared;
		linux,phandle = <0xc>;
		phandle = <0xc>;

		opp00 {
			opp-hz = <0x0 0xc65d400>;
			opp-microvolt = <0xfde80>;
			clock-latency-ns = <0x7a120>;
		};

		opp01 {
			opp-hz = <0x0 0x19bfcc00>;
			opp-microvolt = <0xfde80>;
			clock-latency-ns = <0x7a120>;
		};

		opp02 {
			opp-hz = <0x0 0x2b73a840>;
			opp-microvolt = <0x10a1d0>;
			clock-latency-ns = <0x7a120>;
		};

		opp03 {
			opp-hz = <0x0 0x39387000>;
			opp-microvolt = <0x120160>;
			clock-latency-ns = <0x7a120>;
		};

		opp04 {
			opp-hz = <0x0 0x47868c00>;
			opp-microvolt = <0x144b50>;
			clock-latency-ns = <0x7a120>;
		};
	};

	interrupt-controller@f6801000 {
		compatible = "arm,gic-400";
		reg = <0x0 0xf6801000 0x0 0x1000 0x0 0xf6802000 0x0 0x2000 0x0 0xf6804000 0x0 0x2000 0x0 0xf6806000 0x0 0x2000>;
		#address-cells = <0x0>;
		#interrupt-cells = <0x3>;
		interrupt-controller;
		interrupts = <0x1 0x9 0xff04>;
		linux,phandle = <0x1>;
		phandle = <0x1>;
	};

	timer {
		compatible = "arm,armv8-timer";
		interrupt-parent = <0x1>;
		interrupts = <0x1 0xd 0xff08 0x1 0xe 0xff08 0x1 0xb 0xff08 0x1 0xa 0xff08>;
	};

	soc {
		compatible = "simple-bus";
		#address-cells = <0x2>;
		#size-cells = <0x2>;
		#sound-dai-cells = <0x0>;
		interrupt-parent = <0x1>;
		ranges;

		sram@fff80000 {
			compatible = "hisilicon,hi6220-sramctrl", "syscon";
			reg = <0x0 0xfff80000 0x0 0x12000>;
			linux,phandle = <0x12>;
			phandle = <0x12>;
		};

		ao_ctrl@f7800000 {
			compatible = "hisilicon,hi6220-aoctrl", "syscon";
			reg = <0x0 0xf7800000 0x0 0x2000>;
			#clock-cells = <0x1>;
			linux,phandle = <0x14>;
			phandle = <0x14>;
		};

		sys_ctrl@f7030000 {
			compatible = "hisilicon,hi6220-sysctrl", "syscon";
			reg = <0x0 0xf7030000 0x0 0x2000>;
			#clock-cells = <0x1>;
			#reset-cells = <0x1>;
			linux,phandle = <0x15>;
			phandle = <0x15>;
		};

		media_ctrl@f4410000 {
			compatible = "hisilicon,hi6220-mediactrl", "syscon";
			reg = <0x0 0xf4410000 0x0 0x1000>;
			#clock-cells = <0x1>;
			#reset-cells = <0x1>;
			linux,phandle = <0x55>;
			phandle = <0x55>;
		};

		pm_ctrl@f7032000 {
			compatible = "hisilicon,hi6220-pmctrl", "syscon";
			reg = <0x0 0xf7032000 0x0 0x1000>;
			#clock-cells = <0x1>;
		};

		stub_clock {
			compatible = "hisilicon,hi6220-stub-clk";
			hisilicon,hi6220-clk-sram = <0x12>;
			#clock-cells = <0x1>;
			mbox-names = "mbox-tx";
			mboxes = <0x13 0x1 0x0 0xb>;
			linux,phandle = <0xb>;
			phandle = <0xb>;
		};

		medianoc_ade@f4520000 {
			compatible = "syscon";
			reg = <0x0 0xf4520000 0x0 0x4000>;
			linux,phandle = <0x54>;
			phandle = <0x54>;
		};

		uart@f8015000 {
			compatible = "arm,pl011", "arm,primecell";
			reg = <0x0 0xf8015000 0x0 0x1000>;
			interrupts = <0x0 0x24 0x4>;
			clocks = <0x14 0x24 0x14 0x24>;
			clock-names = "uartclk", "apb_pclk";
		};

		uart@f7111000 {
			compatible = "arm,pl011", "arm,primecell";
			reg = <0x0 0xf7111000 0x0 0x1000>;
			interrupts = <0x0 0x25 0x4>;
			clocks = <0x15 0x11 0x15 0x11>;
			clock-names = "uartclk", "apb_pclk";
			pinctrl-names = "default";
			pinctrl-0 = <0x16 0x17 0x18>;
			status = "ok";
		};

		uart@f7112000 {
			compatible = "arm,pl011", "arm,primecell";
			reg = <0x0 0xf7112000 0x0 0x1000>;
			interrupts = <0x0 0x26 0x4>;
			clocks = <0x15 0x12 0x15 0x12>;
			clock-names = "uartclk", "apb_pclk";
			pinctrl-names = "default";
			pinctrl-0 = <0x19 0x1a>;
			status = "ok";
		};

		uart@f7113000 {
			compatible = "arm,pl011", "arm,primecell";
			reg = <0x0 0xf7113000 0x0 0x1000>;
			interrupts = <0x0 0x27 0x4>;
			clocks = <0x15 0x13 0x15 0x13>;
			clock-names = "uartclk", "apb_pclk";
			pinctrl-names = "default";
			pinctrl-0 = <0x1b 0x1c>;
			status = "ok";
		};

		uart@f7114000 {
			compatible = "arm,pl011", "arm,primecell";
			reg = <0x0 0xf7114000 0x0 0x1000>;
			interrupts = <0x0 0x28 0x4>;
			clocks = <0x15 0x14 0x15 0x14>;
			clock-names = "uartclk", "apb_pclk";
			pinctrl-names = "default";
			pinctrl-0 = <0x1d 0x1e>;
			status = "disabled";
		};

		dma@f7370000 {
			compatible = "hisilicon,k3-dma-1.0";
			reg = <0x0 0xf7370000 0x0 0x1000>;
			#dma-cells = <0x1>;
			dma-channels = <0xf>;
			dma-requests = <0x20>;
			interrupts = <0x0 0x54 0x4>;
			clocks = <0x15 0xb>;
			dma-no-cci;
			dma-type = "hi6220_dma";
			status = "ok";
			linux,phandle = <0x2c>;
			phandle = <0x2c>;
		};

		dual_timer@f8008000 {
			compatible = "arm,sp804", "arm,primecell";
			reg = <0x0 0xf8008000 0x0 0x1000>;
			interrupts = <0x0 0xe 0x4 0x0 0xf 0x4>;
			clocks = <0x14 0x1b>;
			clock-names = "apb_pclk";
		};

		rtc@170000 {
			compatible = "arm,pl031", "arm,primecell";
			reg = <0x0 0xf8003000 0x0 0x1000>;
			interrupts = <0x0 0xc 0x4>;
			clocks = <0x14 0x29>;
			clock-names = "apb_pclk";
		};

		pinmux@f7010000 {
			compatible = "pinctrl-single";
			reg = <0x0 0xf7010000 0x0 0x27c>;
			#address-cells = <0x1>;
			#size-cells = <0x1>;
			#gpio-range-cells = <0x3>;
			pinctrl-single,register-width = <0x20>;
			pinctrl-single,function-mask = <0x7>;
			pinctrl-single,gpio-range = <0x1f 0x50 0x8 0x0 0x1f 0x58 0x8 0x0 0x1f 0x60 0x8 0x0 0x1f 0x68 0x8 0x0 0x1f 0x70 0x8 0x0 0x1f 0x78 0x2 0x0 0x1f 0x2 0x6 0x1 0x1f 0x8 0x8 0x1 0x1f 0x0 0x1 0x1 0x1f 0x10 0x7 0x1 0x1f 0x17 0x3 0x1 0x1f 0x1c 0x5 0x1 0x1f 0x21 0x3 0x1 0x1f 0x2b 0x5 0x1 0x1f 0x30 0x8 0x1 0x1f 0x38 0x8 0x1 0x1f 0x4a 0x6 0x1 0x1f 0x7a 0x1 0x1 0x1f 0x7e 0x1 0x1 0x1f 0x7f 0x8 0x1 0x1f 0x87 0x8 0x1 0x1f 0x8f 0x8 0x1 0x1f 0x97 0x8 0x1>;
			pinctrl-names = "default";
			pinctrl-0 = <0x20 0x21 0x22 0x23 0x24>;
			linux,phandle = <0x2b>;
			phandle = <0x2b>;

			gpio-range {
				#pinctrl-single,gpio-range-cells = <0x3>;
				linux,phandle = <0x1f>;
				phandle = <0x1f>;
			};

			boot_sel_pmx_func {
				pinctrl-single,pins = <0x0 0x0>;
				linux,phandle = <0x20>;
				phandle = <0x20>;
			};

			emmc_pmx_func {
				pinctrl-single,pins = <0x100 0x0 0x104 0x0 0x108 0x0 0x10c 0x0 0x110 0x0 0x114 0x0 0x118 0x0 0x11c 0x0 0x120 0x0 0x124 0x0>;
				linux,phandle = <0x3c>;
				phandle = <0x3c>;
			};

			sd_pmx_func {
				pinctrl-single,pins = <0xc 0x0 0x10 0x0 0x14 0x0 0x18 0x0 0x1c 0x0 0x20 0x0>;
				linux,phandle = <0x42>;
				phandle = <0x42>;
			};

			sd_pmx_idle {
				pinctrl-single,pins = <0xc 0x1 0x10 0x1 0x14 0x1 0x18 0x1 0x1c 0x1 0x20 0x1>;
				linux,phandle = <0x45>;
				phandle = <0x45>;
			};

			sdio_pmx_func {
				pinctrl-single,pins = <0x128 0x0 0x12c 0x0 0x130 0x0 0x134 0x0 0x138 0x0 0x13c 0x0>;
				linux,phandle = <0x48>;
				phandle = <0x48>;
			};

			sdio_pmx_idle {
				pinctrl-single,pins = <0x128 0x1 0x12c 0x1 0x130 0x1 0x134 0x1 0x138 0x1 0x13c 0x1>;
				linux,phandle = <0x4b>;
				phandle = <0x4b>;
			};

			isp_pmx_func {
				pinctrl-single,pins = <0x24 0x0 0x28 0x0 0x2c 0x0 0x30 0x1 0x34 0x1 0x38 0x1 0x3c 0x0 0x40 0x0 0x44 0x0 0x48 0x0 0x4c 0x1 0x50 0x1 0x54 0x0 0x58 0x0 0x5c 0x0 0x60 0x0>;
			};

			hkadc_ssi_pmx_func {
				pinctrl-single,pins = <0x68 0x0>;
				linux,phandle = <0x21>;
				phandle = <0x21>;
			};

			codec_clk_pmx_func {
				pinctrl-single,pins = <0x6c 0x0>;
				linux,phandle = <0x22>;
				phandle = <0x22>;
			};

			codec_pmx_func {
				pinctrl-single,pins = <0x70 0x1 0x74 0x0 0x78 0x0 0x7c 0x0>;
			};

			fm_pmx_func {
				pinctrl-single,pins = <0x80 0x1 0x84 0x1 0x88 0x1 0x8c 0x1>;
			};

			bt_pmx_func {
				pinctrl-single,pins = <0x90 0x0 0x94 0x0 0x98 0x0 0x9c 0x0>;
				linux,phandle = <0x4f>;
				phandle = <0x4f>;
			};

			pwm_in_pmx_func {
				pinctrl-single,pins = <0xb8 0x1>;
				linux,phandle = <0x23>;
				phandle = <0x23>;
			};

			bl_pwm_pmx_func {
				pinctrl-single,pins = <0xbc 0x1>;
				linux,phandle = <0x24>;
				phandle = <0x24>;
			};

			uart0_pmx_func {
				pinctrl-single,pins = <0xc0 0x0 0xc4 0x0>;
			};

			uart1_pmx_func {
				pinctrl-single,pins = <0xc8 0x0 0xcc 0x0 0xd0 0x0 0xd4 0x0>;
				linux,phandle = <0x16>;
				phandle = <0x16>;
			};

			uart2_pmx_func {
				pinctrl-single,pins = <0xd8 0x0 0xdc 0x0 0xe0 0x0 0xe4 0x0>;
				linux,phandle = <0x19>;
				phandle = <0x19>;
			};

			uart3_pmx_func {
				pinctrl-single,pins = <0x180 0x1 0x184 0x1 0x188 0x1 0x18c 0x1>;
				linux,phandle = <0x1b>;
				phandle = <0x1b>;
			};

			uart4_pmx_func {
				pinctrl-single,pins = <0x1d0 0x1 0x1d4 0x1 0x1d8 0x1 0x1dc 0x1>;
				linux,phandle = <0x1d>;
				phandle = <0x1d>;
			};

			uart5_pmx_func {
				pinctrl-single,pins = <0x1c8 0x1 0x1cc 0x1>;
			};

			i2c0_pmx_func {
				pinctrl-single,pins = <0xe8 0x0 0xec 0x0>;
				linux,phandle = <0x30>;
				phandle = <0x30>;
			};

			i2c1_pmx_func {
				pinctrl-single,pins = <0xf0 0x0 0xf4 0x0>;
				linux,phandle = <0x32>;
				phandle = <0x32>;
			};

			i2c2_pmx_func {
				pinctrl-single,pins = <0xf8 0x0 0xfc 0x0>;
				linux,phandle = <0x34>;
				phandle = <0x34>;
			};

			spi0_pmx_func {
				pinctrl-single,pins = <0x1a0 0x1 0x1a4 0x1 0x1a8 0x1 0x1ac 0x1>;
				linux,phandle = <0x2d>;
				phandle = <0x2d>;
			};
		};

		pinmux@f7010800 {
			compatible = "pinconf-single";
			reg = <0x0 0xf7010800 0x0 0x28c>;
			#address-cells = <0x1>;
			#size-cells = <0x1>;
			pinctrl-single,register-width = <0x20>;
			pinctrl-names = "default";
			pinctrl-0 = <0x25 0x26 0x27 0x28 0x29>;

			boot_sel_cfg_func {
				pinctrl-single,pins = <0x0 0x0>;
				pinctrl-single,bias-pulldown = <0x0 0x2 0x0 0x2>;
				pinctrl-single,bias-pullup = <0x1 0x1 0x0 0x1>;
				pinctrl-single,drive-strength = <0x0 0x70>;
				linux,phandle = <0x25>;
				phandle = <0x25>;
			};

			hkadc_ssi_cfg_func {
				pinctrl-single,pins = <0x6c 0x0>;
				pinctrl-single,bias-pulldown = <0x0 0x2 0x0 0x2>;
				pinctrl-single,bias-pullup = <0x0 0x1 0x0 0x1>;
				pinctrl-single,drive-strength = <0x0 0x70>;
				linux,phandle = <0x26>;
				phandle = <0x26>;
			};

			emmc_clk_cfg_func {
				pinctrl-single,pins = <0x104 0x0>;
				pinctrl-single,bias-pulldown = <0x0 0x2 0x0 0x2>;
				pinctrl-single,bias-pullup = <0x0 0x1 0x0 0x1>;
				pinctrl-single,drive-strength = <0x20 0x70>;
				linux,phandle = <0x3d>;
				phandle = <0x3d>;
			};

			emmc_cfg_func {
				pinctrl-single,pins = <0x108 0x0 0x10c 0x0 0x110 0x0 0x114 0x0 0x118 0x0 0x11c 0x0 0x120 0x0 0x124 0x0 0x128 0x0>;
				pinctrl-single,bias-pulldown = <0x0 0x2 0x0 0x2>;
				pinctrl-single,bias-pullup = <0x1 0x1 0x0 0x1>;
				pinctrl-single,drive-strength = <0x10 0x70>;
				linux,phandle = <0x3e>;
				phandle = <0x3e>;
			};

			emmc_rst_cfg_func {
				pinctrl-single,pins = <0x12c 0x0>;
				pinctrl-single,bias-pulldown = <0x0 0x2 0x0 0x2>;
				pinctrl-single,bias-pullup = <0x0 0x1 0x0 0x1>;
				pinctrl-single,drive-strength = <0x10 0x70>;
				linux,phandle = <0x3f>;
				phandle = <0x3f>;
			};

			sd_clk_cfg_func {
				pinctrl-single,pins = <0xc 0x0>;
				pinctrl-single,bias-pulldown = <0x0 0x2 0x0 0x2>;
				pinctrl-single,bias-pullup = <0x0 0x1 0x0 0x1>;
				pinctrl-single,drive-strength = <0x30 0x70>;
				linux,phandle = <0x43>;
				phandle = <0x43>;
			};

			sd_clk_cfg_idle {
				pinctrl-single,pins = <0xc 0x0>;
				pinctrl-single,bias-pulldown = <0x2 0x2 0x0 0x2>;
				pinctrl-single,bias-pullup = <0x0 0x1 0x0 0x1>;
				pinctrl-single,drive-strength = <0x0 0x70>;
				linux,phandle = <0x46>;
				phandle = <0x46>;
			};

			sd_cfg_func {
				pinctrl-single,pins = <0x10 0x0 0x14 0x0 0x18 0x0 0x1c 0x0 0x20 0x0>;
				pinctrl-single,bias-pulldown = <0x0 0x2 0x0 0x2>;
				pinctrl-single,bias-pullup = <0x0 0x1 0x0 0x1>;
				pinctrl-single,drive-strength = <0x20 0x70>;
				linux,phandle = <0x44>;
				phandle = <0x44>;
			};

			sd_cfg_idle {
				pinctrl-single,pins = <0x10 0x0 0x14 0x0 0x18 0x0 0x1c 0x0 0x20 0x0>;
				pinctrl-single,bias-pulldown = <0x2 0x2 0x0 0x2>;
				pinctrl-single,bias-pullup = <0x0 0x1 0x0 0x1>;
				pinctrl-single,drive-strength = <0x0 0x70>;
				linux,phandle = <0x47>;
				phandle = <0x47>;
			};

			sdio_clk_cfg_func {
				pinctrl-single,pins = <0x134 0x0>;
				pinctrl-single,bias-pulldown = <0x0 0x2 0x0 0x2>;
				pinctrl-single,bias-pullup = <0x0 0x1 0x0 0x1>;
				pinctrl-single,drive-strength = <0x20 0x70>;
				linux,phandle = <0x49>;
				phandle = <0x49>;
			};

			sdio_clk_cfg_idle {
				pinctrl-single,pins = <0x134 0x0>;
				pinctrl-single,bias-pulldown = <0x2 0x2 0x0 0x2>;
				pinctrl-single,bias-pullup = <0x0 0x1 0x0 0x1>;
				pinctrl-single,drive-strength = <0x0 0x70>;
				linux,phandle = <0x4c>;
				phandle = <0x4c>;
			};

			sdio_cfg_func {
				pinctrl-single,pins = <0x138 0x0 0x13c 0x0 0x140 0x0 0x144 0x0 0x148 0x0>;
				pinctrl-single,bias-pulldown = <0x0 0x2 0x0 0x2>;
				pinctrl-single,bias-pullup = <0x1 0x1 0x0 0x1>;
				pinctrl-single,drive-strength = <0x10 0x70>;
				linux,phandle = <0x4a>;
				phandle = <0x4a>;
			};

			sdio_cfg_idle {
				pinctrl-single,pins = <0x138 0x0 0x13c 0x0 0x140 0x0 0x144 0x0 0x148 0x0>;
				pinctrl-single,bias-pulldown = <0x0 0x2 0x0 0x2>;
				pinctrl-single,bias-pullup = <0x1 0x1 0x0 0x1>;
				pinctrl-single,drive-strength = <0x0 0x70>;
				linux,phandle = <0x4d>;
				phandle = <0x4d>;
			};

			isp_cfg_func1 {
				pinctrl-single,pins = <0x28 0x0 0x2c 0x0 0x30 0x0 0x34 0x0 0x38 0x0 0x3c 0x0 0x40 0x0 0x44 0x0 0x48 0x0 0x4c 0x0 0x50 0x0 0x58 0x0 0x5c 0x0 0x60 0x0 0x64 0x0>;
				pinctrl-single,bias-pulldown = <0x0 0x2 0x0 0x2>;
				pinctrl-single,bias-pullup = <0x0 0x1 0x0 0x1>;
				pinctrl-single,drive-strength = <0x0 0x70>;
			};

			isp_cfg_idle1 {
				pinctrl-single,pins = <0x34 0x0 0x38 0x0>;
				pinctrl-single,bias-pulldown = <0x2 0x2 0x0 0x2>;
				pinctrl-single,bias-pullup = <0x0 0x1 0x0 0x1>;
				pinctrl-single,drive-strength = <0x0 0x70>;
			};

			isp_cfg_func2 {
				pinctrl-single,pins = <0x54 0x0>;
				pinctrl-single,bias-pulldown = <0x2 0x2 0x0 0x2>;
				pinctrl-single,bias-pullup = <0x0 0x1 0x0 0x1>;
				pinctrl-single,drive-strength = <0x0 0x70>;
			};

			codec_clk_cfg_func {
				pinctrl-single,pins = <0x70 0x0>;
				pinctrl-single,bias-pulldown = <0x0 0x2 0x0 0x2>;
				pinctrl-single,bias-pullup = <0x0 0x1 0x0 0x1>;
				pinctrl-single,drive-strength = <0x10 0x70>;
				linux,phandle = <0x27>;
				phandle = <0x27>;
			};

			codec_clk_cfg_idle {
				pinctrl-single,pins = <0x70 0x0>;
				pinctrl-single,bias-pulldown = <0x0 0x2 0x0 0x2>;
				pinctrl-single,bias-pullup = <0x0 0x1 0x0 0x1>;
				pinctrl-single,drive-strength = <0x0 0x70>;
			};

			codec_cfg_func1 {
				pinctrl-single,pins = <0x74 0x0>;
				pinctrl-single,bias-pulldown = <0x2 0x2 0x0 0x2>;
				pinctrl-single,bias-pullup = <0x0 0x1 0x0 0x1>;
				pinctrl-single,drive-strength = <0x0 0x70>;
			};

			codec_cfg_func2 {
				pinctrl-single,pins = <0x78 0x0 0x7c 0x0 0x80 0x0>;
				pinctrl-single,bias-pulldown = <0x0 0x2 0x0 0x2>;
				pinctrl-single,bias-pullup = <0x0 0x1 0x0 0x1>;
				pinctrl-single,drive-strength = <0x10 0x70>;
			};

			codec_cfg_idle2 {
				pinctrl-single,pins = <0x78 0x0 0x7c 0x0 0x80 0x0>;
				pinctrl-single,bias-pulldown = <0x0 0x2 0x0 0x2>;
				pinctrl-single,bias-pullup = <0x0 0x1 0x0 0x1>;
				pinctrl-single,drive-strength = <0x0 0x70>;
			};

			fm_cfg_func {
				pinctrl-single,pins = <0x84 0x0 0x88 0x0 0x8c 0x0 0x90 0x0>;
				pinctrl-single,bias-pulldown = <0x2 0x2 0x0 0x2>;
				pinctrl-single,bias-pullup = <0x0 0x1 0x0 0x1>;
				pinctrl-single,drive-strength = <0x0 0x70>;
			};

			bt_cfg_func {
				pinctrl-single,pins = <0x94 0x0 0x98 0x0 0x9c 0x0 0xa0 0x0>;
				pinctrl-single,bias-pulldown = <0x0 0x2 0x0 0x2>;
				pinctrl-single,bias-pullup = <0x0 0x1 0x0 0x1>;
				pinctrl-single,drive-strength = <0x0 0x70>;
				linux,phandle = <0x50>;
				phandle = <0x50>;
			};

			bt_cfg_idle {
				pinctrl-single,pins = <0x94 0x0 0x98 0x0 0x9c 0x0 0xa0 0x0>;
				pinctrl-single,bias-pulldown = <0x2 0x2 0x0 0x2>;
				pinctrl-single,bias-pullup = <0x0 0x1 0x0 0x1>;
				pinctrl-single,drive-strength = <0x0 0x70>;
			};

			pwm_in_cfg_func {
				pinctrl-single,pins = <0xbc 0x0>;
				pinctrl-single,bias-pulldown = <0x2 0x2 0x0 0x2>;
				pinctrl-single,bias-pullup = <0x0 0x1 0x0 0x1>;
				pinctrl-single,drive-strength = <0x0 0x70>;
				linux,phandle = <0x28>;
				phandle = <0x28>;
			};

			bl_pwm_cfg_func {
				pinctrl-single,pins = <0xc0 0x0>;
				pinctrl-single,bias-pulldown = <0x2 0x2 0x0 0x2>;
				pinctrl-single,bias-pullup = <0x0 0x1 0x0 0x1>;
				pinctrl-single,drive-strength = <0x0 0x70>;
				linux,phandle = <0x29>;
				phandle = <0x29>;
			};

			uart0_cfg_func1 {
				pinctrl-single,pins = <0xc4 0x0>;
				pinctrl-single,bias-pulldown = <0x0 0x2 0x0 0x2>;
				pinctrl-single,bias-pullup = <0x1 0x1 0x0 0x1>;
				pinctrl-single,drive-strength = <0x0 0x70>;
			};

			uart0_cfg_func2 {
				pinctrl-single,pins = <0xc8 0x0>;
				pinctrl-single,bias-pulldown = <0x0 0x2 0x0 0x2>;
				pinctrl-single,bias-pullup = <0x0 0x1 0x0 0x1>;
				pinctrl-single,drive-strength = <0x10 0x70>;
			};

			uart1_cfg_func1 {
				pinctrl-single,pins = <0xcc 0x0 0xd4 0x0>;
				pinctrl-single,bias-pulldown = <0x0 0x2 0x0 0x2>;
				pinctrl-single,bias-pullup = <0x1 0x1 0x0 0x1>;
				pinctrl-single,drive-strength = <0x0 0x70>;
				linux,phandle = <0x17>;
				phandle = <0x17>;
			};

			uart1_cfg_func2 {
				pinctrl-single,pins = <0xd0 0x0 0xd8 0x0>;
				pinctrl-single,bias-pulldown = <0x0 0x2 0x0 0x2>;
				pinctrl-single,bias-pullup = <0x0 0x1 0x0 0x1>;
				pinctrl-single,drive-strength = <0x0 0x70>;
				linux,phandle = <0x18>;
				phandle = <0x18>;
			};

			uart2_cfg_func {
				pinctrl-single,pins = <0xdc 0x0 0xe0 0x0 0xe4 0x0 0xe8 0x0>;
				pinctrl-single,bias-pulldown = <0x0 0x2 0x0 0x2>;
				pinctrl-single,bias-pullup = <0x0 0x1 0x0 0x1>;
				pinctrl-single,drive-strength = <0x0 0x70>;
				linux,phandle = <0x1a>;
				phandle = <0x1a>;
			};

			uart3_cfg_func {
				pinctrl-single,pins = <0x190 0x0 0x194 0x0 0x198 0x0 0x19c 0x0>;
				pinctrl-single,bias-pulldown = <0x2 0x2 0x0 0x2>;
				pinctrl-single,bias-pullup = <0x0 0x1 0x0 0x1>;
				pinctrl-single,drive-strength = <0x0 0x70>;
				linux,phandle = <0x1c>;
				phandle = <0x1c>;
			};

			uart4_cfg_func {
				pinctrl-single,pins = <0x1e0 0x0 0x1e4 0x0 0x1e8 0x0 0x1ec 0x0>;
				pinctrl-single,bias-pulldown = <0x2 0x2 0x0 0x2>;
				pinctrl-single,bias-pullup = <0x0 0x1 0x0 0x1>;
				pinctrl-single,drive-strength = <0x0 0x70>;
				linux,phandle = <0x1e>;
				phandle = <0x1e>;
			};

			uart5_cfg_func {
				pinctrl-single,pins = <0x1d8 0x0 0x1dc 0x0>;
				pinctrl-single,bias-pulldown = <0x2 0x2 0x0 0x2>;
				pinctrl-single,bias-pullup = <0x0 0x1 0x0 0x1>;
				pinctrl-single,drive-strength = <0x0 0x70>;
			};

			i2c0_cfg_func {
				pinctrl-single,pins = <0xec 0x0 0xf0 0x0>;
				pinctrl-single,bias-pulldown = <0x0 0x2 0x0 0x2>;
				pinctrl-single,bias-pullup = <0x0 0x1 0x0 0x1>;
				pinctrl-single,drive-strength = <0x0 0x70>;
				linux,phandle = <0x31>;
				phandle = <0x31>;
			};

			i2c1_cfg_func {
				pinctrl-single,pins = <0xf4 0x0 0xf8 0x0>;
				pinctrl-single,bias-pulldown = <0x0 0x2 0x0 0x2>;
				pinctrl-single,bias-pullup = <0x0 0x1 0x0 0x1>;
				pinctrl-single,drive-strength = <0x0 0x70>;
				linux,phandle = <0x33>;
				phandle = <0x33>;
			};

			i2c2_cfg_func {
				pinctrl-single,pins = <0xfc 0x0 0x100 0x0>;
				pinctrl-single,bias-pulldown = <0x0 0x2 0x0 0x2>;
				pinctrl-single,bias-pullup = <0x0 0x1 0x0 0x1>;
				pinctrl-single,drive-strength = <0x0 0x70>;
				linux,phandle = <0x35>;
				phandle = <0x35>;
			};

			spi0_cfg_func {
				pinctrl-single,pins = <0x1b0 0x0 0x1b4 0x0 0x1b8 0x0 0x1bc 0x0>;
				pinctrl-single,bias-pulldown = <0x0 0x2 0x0 0x2>;
				pinctrl-single,bias-pullup = <0x0 0x1 0x0 0x1>;
				pinctrl-single,drive-strength = <0x0 0x70>;
				linux,phandle = <0x2e>;
				phandle = <0x2e>;
			};
		};

		pinmux@f8001800 {
			compatible = "pinconf-single";
			reg = <0x0 0xf8001800 0x0 0x78>;
			#address-cells = <0x1>;
			#size-cells = <0x1>;
			pinctrl-single,register-width = <0x20>;
			pinctrl-names = "default";
			pinctrl-0 = <0x2a>;

			rstout_n_cfg_func {
				pinctrl-single,pins = <0x0 0x0>;
				pinctrl-single,bias-pulldown = <0x0 0x2 0x0 0x2>;
				pinctrl-single,bias-pullup = <0x0 0x1 0x0 0x1>;
				pinctrl-single,drive-strength = <0x0 0x70>;
				linux,phandle = <0x2a>;
				phandle = <0x2a>;
			};

			pmu_peri_en_cfg_func {
				pinctrl-single,pins = <0x4 0x0>;
				pinctrl-single,bias-pulldown = <0x0 0x2 0x0 0x2>;
				pinctrl-single,bias-pullup = <0x0 0x1 0x0 0x1>;
				pinctrl-single,drive-strength = <0x0 0x70>;
			};

			sysclk0_en_cfg_func {
				pinctrl-single,pins = <0x8 0x0>;
				pinctrl-single,bias-pulldown = <0x0 0x2 0x0 0x2>;
				pinctrl-single,bias-pullup = <0x0 0x1 0x0 0x1>;
				pinctrl-single,drive-strength = <0x0 0x70>;
			};

			jtag_tdo_cfg_func {
				pinctrl-single,pins = <0xc 0x0>;
				pinctrl-single,bias-pulldown = <0x0 0x2 0x0 0x2>;
				pinctrl-single,bias-pullup = <0x0 0x1 0x0 0x1>;
				pinctrl-single,drive-strength = <0x20 0x70>;
			};

			rf_reset_cfg_func {
				pinctrl-single,pins = <0x70 0x0 0x74 0x0>;
				pinctrl-single,bias-pulldown = <0x0 0x2 0x0 0x2>;
				pinctrl-single,bias-pullup = <0x0 0x1 0x0 0x1>;
				pinctrl-single,drive-strength = <0x0 0x70>;
			};
		};

		gpio@f8011000 {
			compatible = "arm,pl061", "arm,primecell";
			reg = <0x0 0xf8011000 0x0 0x1000>;
			interrupts = <0x0 0x34 0x4>;
			gpio-controller;
			#gpio-cells = <0x2>;
			interrupt-controller;
			#interrupt-cells = <0x2>;
			clocks = <0x14 0x2>;
			clock-names = "apb_pclk";
			status = "ok";
			linux,phandle = <0x37>;
			phandle = <0x37>;
		};

		gpio@f8012000 {
			compatible = "arm,pl061", "arm,primecell";
			reg = <0x0 0xf8012000 0x0 0x1000>;
			interrupts = <0x0 0x35 0x4>;
			gpio-controller;
			#gpio-cells = <0x2>;
			interrupt-controller;
			#interrupt-cells = <0x2>;
			clocks = <0x14 0x2>;
			clock-names = "apb_pclk";
			status = "ok";
			linux,phandle = <0x36>;
			phandle = <0x36>;
		};

		gpio@f8013000 {
			compatible = "arm,pl061", "arm,primecell";
			reg = <0x0 0xf8013000 0x0 0x1000>;
			interrupts = <0x0 0x36 0x4>;
			gpio-controller;
			#gpio-cells = <0x2>;
			interrupt-controller;
			#interrupt-cells = <0x2>;
			clocks = <0x14 0x2>;
			clock-names = "apb_pclk";
			status = "ok";
			linux,phandle = <0x5b>;
			phandle = <0x5b>;
		};

		gpio@f8014000 {
			compatible = "arm,pl061", "arm,primecell";
			reg = <0x0 0xf8014000 0x0 0x1000>;
			interrupts = <0x0 0x37 0x4>;
			gpio-controller;
			#gpio-cells = <0x2>;
			gpio-ranges = <0x2b 0x0 0x50 0x8>;
			interrupt-controller;
			#interrupt-cells = <0x2>;
			clocks = <0x14 0x2>;
			clock-names = "apb_pclk";
			status = "ok";
			linux,phandle = <0x64>;
			phandle = <0x64>;
		};

		gpio@f7020000 {
			compatible = "arm,pl061", "arm,primecell";
			reg = <0x0 0xf7020000 0x0 0x1000>;
			interrupts = <0x0 0x38 0x4>;
			gpio-controller;
			#gpio-cells = <0x2>;
			gpio-ranges = <0x2b 0x0 0x58 0x8>;
			interrupt-controller;
			#interrupt-cells = <0x2>;
			clocks = <0x14 0x2>;
			clock-names = "apb_pclk";
			status = "ok";
			linux,phandle = <0x65>;
			phandle = <0x65>;
		};

		gpio@f7021000 {
			compatible = "arm,pl061", "arm,primecell";
			reg = <0x0 0xf7021000 0x0 0x1000>;
			interrupts = <0x0 0x39 0x4>;
			gpio-controller;
			#gpio-cells = <0x2>;
			gpio-ranges = <0x2b 0x0 0x60 0x8>;
			interrupt-controller;
			#interrupt-cells = <0x2>;
			clocks = <0x14 0x2>;
			clock-names = "apb_pclk";
			status = "ok";
			linux,phandle = <0x66>;
			phandle = <0x66>;
		};

		gpio@f7022000 {
			compatible = "arm,pl061", "arm,primecell";
			reg = <0x0 0xf7022000 0x0 0x1000>;
			interrupts = <0x0 0x3a 0x4>;
			gpio-controller;
			#gpio-cells = <0x2>;
			gpio-ranges = <0x2b 0x0 0x68 0x8>;
			interrupt-controller;
			#interrupt-cells = <0x2>;
			clocks = <0x14 0x2>;
			clock-names = "apb_pclk";
			status = "ok";
			linux,phandle = <0x2f>;
			phandle = <0x2f>;
		};

		gpio@f7023000 {
			compatible = "arm,pl061", "arm,primecell";
			reg = <0x0 0xf7023000 0x0 0x1000>;
			interrupts = <0x0 0x3b 0x4>;
			gpio-controller;
			#gpio-cells = <0x2>;
			gpio-ranges = <0x2b 0x0 0x70 0x8>;
			interrupt-controller;
			#interrupt-cells = <0x2>;
			clocks = <0x14 0x2>;
			clock-names = "apb_pclk";
			status = "ok";
			linux,phandle = <0x67>;
			phandle = <0x67>;
		};

		gpio@f7024000 {
			compatible = "arm,pl061", "arm,primecell";
			reg = <0x0 0xf7024000 0x0 0x1000>;
			interrupts = <0x0 0x3c 0x4>;
			gpio-controller;
			#gpio-cells = <0x2>;
			gpio-ranges = <0x2b 0x0 0x78 0x2 0x2b 0x2 0x2 0x6>;
			interrupt-controller;
			#interrupt-cells = <0x2>;
			clocks = <0x14 0x2>;
			clock-names = "apb_pclk";
			status = "ok";
			linux,phandle = <0x5d>;
			phandle = <0x5d>;
		};

		gpio@f7025000 {
			compatible = "arm,pl061", "arm,primecell";
			reg = <0x0 0xf7025000 0x0 0x1000>;
			interrupts = <0x0 0x3d 0x4>;
			gpio-controller;
			#gpio-cells = <0x2>;
			gpio-ranges = <0x2b 0x0 0x8 0x8>;
			interrupt-controller;
			#interrupt-cells = <0x2>;
			clocks = <0x14 0x2>;
			clock-names = "apb_pclk";
			status = "ok";
			linux,phandle = <0x5e>;
			phandle = <0x5e>;
		};

		gpio@f7026000 {
			compatible = "arm,pl061", "arm,primecell";
			reg = <0x0 0xf7026000 0x0 0x1000>;
			interrupts = <0x0 0x3e 0x4>;
			gpio-controller;
			#gpio-cells = <0x2>;
			gpio-ranges = <0x2b 0x0 0x0 0x1 0x2b 0x1 0x10 0x7>;
			interrupt-controller;
			#interrupt-cells = <0x2>;
			clocks = <0x14 0x2>;
			clock-names = "apb_pclk";
			status = "ok";
			linux,phandle = <0x5c>;
			phandle = <0x5c>;
		};

		gpio@f7027000 {
			compatible = "arm,pl061", "arm,primecell";
			reg = <0x0 0xf7027000 0x0 0x1000>;
			interrupts = <0x0 0x3f 0x4>;
			gpio-controller;
			#gpio-cells = <0x2>;
			gpio-ranges = <0x2b 0x0 0x17 0x3 0x2b 0x3 0x1c 0x5>;
			interrupt-controller;
			#interrupt-cells = <0x2>;
			clocks = <0x14 0x2>;
			clock-names = "apb_pclk";
			status = "ok";
			linux,phandle = <0x5f>;
			phandle = <0x5f>;
		};

		gpio@f7028000 {
			compatible = "arm,pl061", "arm,primecell";
			reg = <0x0 0xf7028000 0x0 0x1000>;
			interrupts = <0x0 0x40 0x4>;
			gpio-controller;
			#gpio-cells = <0x2>;
			gpio-ranges = <0x2b 0x0 0x21 0x3 0x2b 0x3 0x2b 0x5>;
			interrupt-controller;
			#interrupt-cells = <0x2>;
			clocks = <0x14 0x2>;
			clock-names = "apb_pclk";
			status = "ok";
			linux,phandle = <0x60>;
			phandle = <0x60>;
		};

		gpio@f7029000 {
			compatible = "arm,pl061", "arm,primecell";
			reg = <0x0 0xf7029000 0x0 0x1000>;
			interrupts = <0x0 0x41 0x4>;
			gpio-controller;
			#gpio-cells = <0x2>;
			gpio-ranges = <0x2b 0x0 0x30 0x8>;
			interrupt-controller;
			#interrupt-cells = <0x2>;
			clocks = <0x14 0x2>;
			clock-names = "apb_pclk";
			status = "ok";
			linux,phandle = <0x61>;
			phandle = <0x61>;
		};

		gpio@f702a000 {
			compatible = "arm,pl061", "arm,primecell";
			reg = <0x0 0xf702a000 0x0 0x1000>;
			interrupts = <0x0 0x42 0x4>;
			gpio-controller;
			#gpio-cells = <0x2>;
			gpio-ranges = <0x2b 0x0 0x38 0x8>;
			interrupt-controller;
			#interrupt-cells = <0x2>;
			clocks = <0x14 0x2>;
			clock-names = "apb_pclk";
			status = "ok";
			linux,phandle = <0x62>;
			phandle = <0x62>;
		};

		gpio@f702b000 {
			compatible = "arm,pl061", "arm,primecell";
			reg = <0x0 0xf702b000 0x0 0x1000>;
			interrupts = <0x0 0x43 0x4>;
			gpio-controller;
			#gpio-cells = <0x2>;
			gpio-ranges = <0x2b 0x0 0x4a 0x6 0x2b 0x6 0x7a 0x1 0x2b 0x7 0x7e 0x1>;
			interrupt-controller;
			#interrupt-cells = <0x2>;
			clocks = <0x14 0x2>;
			clock-names = "apb_pclk";
			status = "ok";
			linux,phandle = <0x63>;
			phandle = <0x63>;
		};

		gpio@f702c000 {
			compatible = "arm,pl061", "arm,primecell";
			reg = <0x0 0xf702c000 0x0 0x1000>;
			interrupts = <0x0 0x44 0x4>;
			gpio-controller;
			#gpio-cells = <0x2>;
			gpio-ranges = <0x2b 0x0 0x7f 0x8>;
			interrupt-controller;
			#interrupt-cells = <0x2>;
			clocks = <0x14 0x2>;
			clock-names = "apb_pclk";
			status = "ok";
			linux,phandle = <0x68>;
			phandle = <0x68>;
		};

		gpio@f702d000 {
			compatible = "arm,pl061", "arm,primecell";
			reg = <0x0 0xf702d000 0x0 0x1000>;
			interrupts = <0x0 0x45 0x4>;
			gpio-controller;
			#gpio-cells = <0x2>;
			gpio-ranges = <0x2b 0x0 0x87 0x8>;
			interrupt-controller;
			#interrupt-cells = <0x2>;
			clocks = <0x14 0x2>;
			clock-names = "apb_pclk";
			status = "ok";
			linux,phandle = <0x69>;
			phandle = <0x69>;
		};

		gpio@f702e000 {
			compatible = "arm,pl061", "arm,primecell";
			reg = <0x0 0xf702e000 0x0 0x1000>;
			interrupts = <0x0 0x46 0x4>;
			gpio-controller;
			#gpio-cells = <0x2>;
			gpio-ranges = <0x2b 0x0 0x8f 0x8>;
			interrupt-controller;
			#interrupt-cells = <0x2>;
			clocks = <0x14 0x2>;
			clock-names = "apb_pclk";
			status = "ok";
			linux,phandle = <0x6a>;
			phandle = <0x6a>;
		};

		gpio@f702f000 {
			compatible = "arm,pl061", "arm,primecell";
			reg = <0x0 0xf702f000 0x0 0x1000>;
			interrupts = <0x0 0x47 0x4>;
			gpio-controller;
			#gpio-cells = <0x2>;
			gpio-ranges = <0x2b 0x0 0x97 0x8>;
			interrupt-controller;
			#interrupt-cells = <0x2>;
			clocks = <0x14 0x2>;
			clock-names = "apb_pclk";
			status = "ok";
			linux,phandle = <0x6b>;
			phandle = <0x6b>;
		};

		spi@f7106000 {
			compatible = "arm,pl022", "arm,primecell";
			reg = <0x0 0xf7106000 0x0 0x1000>;
			interrupts = <0x0 0x32 0x4>;
			bus-id = <0x0>;
			enable-dma = <0x1>;
			dmas = <0x2c 0xc 0x2c 0xd>;
			dma-names = "rx", "tx";
			clocks = <0x15 0x15>;
			clock-names = "apb_pclk";
			pinctrl-names = "default";
			pinctrl-0 = <0x2d 0x2e>;
			num-cs = <0x1>;
			cs-gpios = <0x2f 0x2 0x0>;
			status = "ok";
			#address-cells = <0x1>;
			#size-cells = <0x0>;

			spidev@0 {
				compatible = "linux,spidev";
				spi-max-frequency = <0x7a120>;
				reg = <0x0>;
				status = "disabled";
			};
		};

		i2c@f7100000 {
			compatible = "snps,designware-i2c";
			reg = <0x0 0xf7100000 0x0 0x1000>;
			interrupts = <0x0 0x2c 0x4>;
			clocks = <0x15 0xd>;
			i2c-sda-hold-time-ns = <0x12c>;
			pinctrl-names = "default";
			pinctrl-0 = <0x30 0x31>;
			status = "ok";
		};

		i2c@f7101000 {
			compatible = "snps,designware-i2c";
			reg = <0x0 0xf7101000 0x0 0x1000>;
			clocks = <0x15 0xe>;
			interrupts = <0x0 0x2d 0x4>;
			i2c-sda-hold-time-ns = <0x12c>;
			pinctrl-names = "default";
			pinctrl-0 = <0x32 0x33>;
			status = "ok";
		};

		i2c@f7102000 {
			compatible = "snps,designware-i2c";
			reg = <0x0 0xf7102000 0x0 0x1000>;
			clocks = <0x15 0xf>;
			interrupts = <0x0 0x2e 0x4>;
			i2c-sda-hold-time-ns = <0x12c>;
			pinctrl-names = "default";
			pinctrl-0 = <0x34 0x35>;
			status = "ok";
			#address-cells = <0x1>;
			#size-cells = <0x0>;

			adv7533@39 {
				compatible = "adi,adv7533";
				reg = <0x39>;
				interrupt-parent = <0x36>;
				interrupts = <0x1 0x2>;
				pd-gpio = <0x37 0x4 0x0>;
				adi,dsi-lanes = <0x4>;
				adi,disable-timing-generator;

				port {

					endpoint {
						remote-endpoint = <0x38>;
						linux,phandle = <0x58>;
						phandle = <0x58>;
					};
				};
			};
		};

		regulator@0 {
			compatible = "regulator-fixed";
			regulator-name = "fixed_5v_hub";
			regulator-min-microvolt = <0x4c4b40>;
			regulator-max-microvolt = <0x4c4b40>;
			regulator-boot-on;
			gpio = <0x37 0x7 0x0>;
			regulator-always-on;
			linux,phandle = <0x39>;
			phandle = <0x39>;
		};

		usbphy {
			compatible = "hisilicon,hi6220-usb-phy";
			#phy-cells = <0x0>;
			phy-supply = <0x39>;
			hisilicon,peripheral-syscon = <0x15>;
			linux,phandle = <0x3a>;
			phandle = <0x3a>;
		};

		usb@f72c0000 {
			compatible = "hisilicon,hi6220-usb";
			reg = <0x0 0xf72c0000 0x0 0x40000>;
			phys = <0x3a>;
			phy-names = "usb2-phy";
			clocks = <0x15 0x7>;
			clock-names = "otg";
			dr_mode = "otg";
			g-use-dma;
			g-rx-fifo-size = <0x200>;
			g-np-tx-fifo-size = <0x80>;
			g-tx-fifo-size = <0x80 0x80 0x80 0x80 0x80 0x80>;
			interrupts = <0x0 0x4d 0x4>;
		};

		mailbox@f7510000 {
			compatible = "hisilicon,hi6220-mbox";
			reg = <0x0 0xf7510000 0x0 0x1000 0x0 0x6dff800 0x0 0x800>;
			interrupts = <0x0 0x5e 0x4>;
			#mbox-cells = <0x3>;
			linux,phandle = <0x13>;
			phandle = <0x13>;
		};

		dwmmc0@f723d000 {
			compatible = "hisilicon,hi6220-dw-mshc";
			num-slots = <0x1>;
			cap-mmc-highspeed;
			sd-uhs-sdr12;
			sd-uhs-sdr25;
			sd-uhs-sdr50;
			non-removable;
			reg = <0x0 0xf723d000 0x0 0x1000>;
			interrupts = <0x0 0x48 0x4>;
			clocks = <0x15 0x2 0x15 0x1>;
			clock-names = "ciu", "biu";
			resets = <0x15 0x0>;
			bus-width = <0x8>;
			vmmc-supply = <0x3b>;
			pinctrl-names = "default";
			pinctrl-0 = <0x3c 0x3d 0x3e 0x3f>;
		};

		dwmmc1@f723e000 {
			compatible = "hisilicon,hi6220-dw-mshc";
			num-slots = <0x1>;
			card-detect-delay = <0xc8>;
			hisilicon,peripheral-syscon = <0x14>;
			cap-sd-highspeed;
			reg = <0x0 0xf723e000 0x0 0x1000>;
			interrupts = <0x0 0x49 0x4>;
			#address-cells = <0x1>;
			#size-cells = <0x0>;
			clocks = <0x15 0x4 0x15 0x3>;
			clock-names = "ciu", "biu";
			resets = <0x15 0x1>;
			vqmmc-supply = <0x40>;
			vmmc-supply = <0x41>;
			bus-width = <0x4>;
			disable-wp;
			cd-gpios = <0x36 0x0 0x1>;
			pinctrl-names = "default", "idle";
			pinctrl-0 = <0x42 0x43 0x44>;
			pinctrl-1 = <0x45 0x46 0x47>;
		};

		dwmmc2@f723f000 {
			compatible = "hisilicon,hi6220-dw-mshc";
			status = "okay";
			num-slots = <0x1>;
			reg = <0x0 0xf723f000 0x0 0x1000>;
			interrupts = <0x0 0x4a 0x4>;
			clocks = <0x15 0x6 0x15 0x5>;
			clock-names = "ciu", "biu";
			resets = <0x15 0x2>;
			bus-width = <0x4>;
			broken-cd;
			pinctrl-names = "default", "idle";
			pinctrl-0 = <0x48 0x49 0x4a>;
			pinctrl-1 = <0x4b 0x4c 0x4d>;
			ti,non-removable;
			non-removable;
			vmmc-supply = <0x4e>;
			#address-cells = <0x1>;
			#size-cells = <0x0>;

			wlcore@2 {
				compatible = "ti,wl1835";
				reg = <0x2>;
				interrupt-parent = <0x36>;
				interrupts = <0x3 0x1>;
			};
		};

		tsensor@0,f7030700 {
			compatible = "hisilicon,tsensor";
			reg = <0x0 0xf7030700 0x0 0x1000>;
			interrupts = <0x0 0x7 0x4>;
			clocks = <0x15 0x16>;
			clock-names = "thermal_clk";
			#thermal-sensor-cells = <0x1>;
			linux,phandle = <0x52>;
			phandle = <0x52>;
		};

		hi6210_i2s {
			compatible = "hisilicon,hi6210-i2s";
			reg = <0x0 0xf7118000 0x0 0x8000 0x0 0xf7030000 0x0 0x400 0x0 0xf7032000 0x0 0x400>;
			interrupts = <0x0 0x7b 0x4>;
			pinctrl-names = "default";
			pinctrl-0 = <0x4f 0x50>;
			clocks = <0x15 0xa 0x15 0x38>;
			clock-names = "dacodec", "i2s-base";
			dmas = <0x2c 0xf 0x2c 0xe>;
			dma-names = "rx", "tx";
			linux,phandle = <0x51>;
			phandle = <0x51>;
		};

		hi6210_hdmi_card {
			compatible = "hisilicon,hi6210-hdmi-audio-card";
			reg = <0x0 0x0 0x0 0x0>;
			sound-dai = <0x51>;
		};

		thermal-zones {

			cls0 {
				polling-delay = <0x3e8>;
				polling-delay-passive = <0x64>;
				sustainable-power = <0xcfe>;
				thermal-sensors = <0x52 0x2>;

				trips {

					trip-point@0 {
						temperature = <0xfde8>;
						hysteresis = <0x3e8>;
						type = "passive";
					};

					trip-point@1 {
						temperature = <0x124f8>;
						hysteresis = <0x3e8>;
						type = "passive";
						linux,phandle = <0x53>;
						phandle = <0x53>;
					};
				};

				cooling-maps {

					map0 {
						trip = <0x53>;
						contribution = <0x400>;
						cooling-device = <0x2 0xffffffff 0xffffffff>;
					};
				};
			};
		};

		mtcmos {
			compatible = "hisilicon,hi6220-mtcmos-driver";
			hisilicon,mtcmos-steady-us = <0xa>;
			hisilicon,mtcmos-sc-on-base = <0xf7800000>;
			hisilicon,mtcmos-acpu-on-base = <0xf65a0000>;

			regulator@a1 {
				regulator-name = "G3D_PD_VDD";
				regulator-compatible = "mtcmos1";
				hisilicon,ctrl-regs = <0x830 0x834 0x83c>;
				hisilicon,ctrl-data = <0x1 0x1>;
				linux,phandle = <0x5a>;
				phandle = <0x5a>;
			};

			regulator@a2 {
				regulator-name = "SOC_MED";
				regulator-compatible = "mtcmos2";
				hisilicon,ctrl-regs = <0x830 0x834 0x83c>;
				hisilicon,ctrl-data = <0x2 0x1>;
			};
		};

		ade@f4100000 {
			compatible = "hisilicon,hi6220-ade";
			reg = <0x0 0xf4100000 0x0 0x7800>;
			reg-names = "ade_base";
			hisilicon,noc-syscon = <0x54>;
			resets = <0x55 0x5>;
			interrupts = <0x0 0x73 0x4>;
			clocks = <0x55 0x5 0x55 0x11 0x55 0x15>;
			clock-names = "clk_ade_core", "clk_codec_jpeg", "clk_ade_pix";
			assigned-clocks = <0x55 0x5 0x55 0x11>;
			assigned-clock-rates = <0x15752a00 0x112a8800>;
			dma-coherent;
			status = "ok";

			port {

				endpoint {
					remote-endpoint = <0x56>;
					linux,phandle = <0x57>;
					phandle = <0x57>;
				};
			};
		};

		dsi@f4107800 {
			compatible = "hisilicon,hi6220-dsi";
			reg = <0x0 0xf4107800 0x0 0x100>;
			clocks = <0x55 0x1>;
			clock-names = "pclk";
			status = "ok";
			#address-cells = <0x1>;
			#size-cells = <0x0>;
			mux-gpio = <0x37 0x1 0x0>;

			ports {
				#address-cells = <0x1>;
				#size-cells = <0x0>;

				port@0 {
					reg = <0x0>;

					endpoint {
						remote-endpoint = <0x57>;
						linux,phandle = <0x56>;
						phandle = <0x56>;
					};
				};

				port@1 {
					#address-cells = <0x1>;
					#size-cells = <0x0>;
					reg = <0x1>;

					endpoint@0 {
						reg = <0x0>;
						remote-endpoint = <0x58>;
						linux,phandle = <0x38>;
						phandle = <0x38>;
					};

					endpoint@1 {
						reg = <0x1>;
						remote-endpoint = <0x59>;
						linux,phandle = <0x6c>;
						phandle = <0x6c>;
					};
				};
			};
		};

		mali@f4080000 {
			compatible = "arm,mali-450", "arm,mali-utgard";
			reg = <0x0 0x3f100000 0x0 0x708000>;
			clocks = <0x55 0x16 0x55 0x2>;
			clock-names = "clk_g3d", "pclk_g3d";
			G3D_PD_VDD-supply = <0x5a>;
			mali_def_freq = <0x1f4>;
			pclk_freq = <0x90>;
			dfs_steps = <0x2>;
			dfs_lockprf = <0x1>;
			dfs_limit_max_prf = <0x1>;
			dfs_profile_num = <0x2>;
			dfs_profiles = <0xfa 0x3 0x0 0x1f4 0x1 0x0>;
			mali_type = <0x2>;
			interrupt-parent = <0x1>;
			interrupts = <0x1 0x7e 0x4 0x1 0x7e 0x4 0x1 0x7e 0x4 0x1 0x7e 0x4 0x1 0x7e 0x4 0x1 0x7e 0x4 0x1 0x7e 0x4 0x1 0x7e 0x4 0x1 0x7e 0x4 0x1 0x7e 0x4 0x1 0x7e 0x4 0x1 0x7e 0x4 0x1 0x7e 0x4 0x1 0x7e 0x4 0x1 0x7e 0x4 0x1 0x7e 0x4>;
			interrupt-names = "IRQGP", "IRQGPMMU", "IRQPP", "IRQPMU", "IRQPP0", "IRQPPMMU0", "IRQPP1", "IRQPPMMU1", "IRQPP2", "IRQPPMMU2", "IRQPP4", "IRQPPMMU4", "IRQPP5", "IRQPPMMU5", "IRQPP6", "IRQPPMMU6";
		};

		fixedregulator@1 {
			compatible = "regulator-fixed";
			regulator-name = "wlan-en-regulator";
			regulator-min-microvolt = <0x1b7740>;
			regulator-max-microvolt = <0x1b7740>;
			gpio = <0x37 0x5 0x0>;
			startup-delay-us = <0x11170>;
			enable-active-high;
			linux,phandle = <0x4e>;
			phandle = <0x4e>;
		};
	};

	gpio_rstout_n {
		gpios;
	};

	gpio_pmu_peri_en {
		gpios;
	};

	gpio_sysclk0_en {
		gpios;
	};

	gpio_jtag_tdo {
		gpios;
	};

	gpio_pwr_hold {
		gpios = <0x37 0x0 0x0>;
	};

	gpio_dsi_sel {
		gpios = <0x37 0x1 0x0>;
	};

	gpio_usb_hub_reset_n {
		gpios = <0x37 0x2 0x0>;
	};

	gpio_usb_sel {
		gpios = <0x37 0x3 0x0>;
	};

	gpio_hdmi_pd {
		gpios = <0x37 0x4 0x0>;
	};

	gpio_wl_en {
		gpios = <0x37 0x5 0x0>;
	};

	gpio_pwron_det {
		gpios = <0x37 0x6 0x0>;
	};

	gpio_usb_dev_det {
		gpios = <0x37 0x7 0x0>;
	};

	gpio_sd_det {
		gpios = <0x36 0x0 0x0>;
	};

	gpio_hdmi_int {
		gpios = <0x36 0x1 0x0>;
	};

	gpio_pmu_irq_n {
		gpios = <0x36 0x2 0x0>;
	};

	gpio_wl_host_wake {
		gpios = <0x36 0x3 0x0>;
	};

	gpio_nfc_int {
		gpios = <0x36 0x4 0x0>;
	};

	gpio_unused_001 {
		gpios = <0x36 0x5 0x0>;
	};

	gpio_bt_reg_on {
		gpios = <0x36 0x7 0x0>;
	};

	gpio_j2_2_0 {
		gpios = <0x5b 0x0 0x0>;
	};

	gpio_j2_2_1 {
		gpios = <0x5b 0x1 0x0>;
	};

	gpio_j2_2_2 {
		gpios = <0x5b 0x2 0x0>;
	};

	gpio_j2_2_3 {
		gpios = <0x5b 0x3 0x0>;
	};

	gpio_j2_2_4 {
		gpios = <0x5b 0x4 0x0>;
	};

	gpio_usb_id_det {
		gpios = <0x5b 0x5 0x0>;
	};

	gpio_vbus_det {
		gpios = <0x5b 0x6 0x0>;
	};

	gpio_j2_2_7 {
		gpios = <0x5b 0x7 0x0>;
	};

	gpio_rf_reset0 {
		gpios;
	};

	gpio_rf_reset1 {
		gpios;
	};

	gpio_boot_sel {
		gpios = <0x5c 0x0 0x0>;
	};

	gpio_pmu_ssi {
		gpios;
	};

	gpio_gps_ref_clk {
		gpios = <0x5d 0x2 0x0>;
	};

	gpio_sd_clk {
		gpios = <0x5d 0x3 0x0>;
	};

	gpio_sd_cmd {
		gpios = <0x5d 0x4 0x0>;
	};

	gpio_sd_data0 {
		gpios = <0x5d 0x5 0x0>;
	};

	gpio_sd_data1 {
		gpios = <0x5d 0x6 0x0>;
	};

	gpio_sd_data2 {
		gpios = <0x5d 0x7 0x0>;
	};

	gpio_sd_data3 {
		gpios = <0x5e 0x0 0x0>;
	};

	gpio_unused_002 {
		gpios;
	};

	gpio_mcam_pwdn {
		gpios = <0x5e 0x1 0x0>;
	};

	gpio_vcm_pwdn {
		gpios = <0x5e 0x2 0x0>;
	};

	gpio_scam_pwdn {
		gpios = <0x5e 0x3 0x0>;
	};

	gpio_cam_id0 {
		gpios = <0x5e 0x4 0x0>;
	};

	gpio_cam_id1 {
		gpios = <0x5e 0x5 0x0>;
	};

	gpio_flash_strobe {
		gpios = <0x5e 0x6 0x0>;
	};

	gpio_mcam_mclk {
		gpios = <0x5e 0x7 0x0>;
	};

	gpio_scam_mclk {
		gpios = <0x5c 0x1 0x0>;
	};

	gpio_cam_reset0 {
		gpios = <0x5c 0x2 0x0>;
	};

	gpio_cam_reset1 {
		gpios = <0x5c 0x3 0x0>;
	};

	gpio_tp_rst_n {
		gpios = <0x5c 0x4 0x0>;
	};

	gpio_unused_003 {
		gpios = <0x5c 0x5 0x0>;
	};

	gpio_isp_sda0 {
		gpios = <0x5c 0x6 0x0>;
	};

	gpio_isp_scl0 {
		gpios = <0x5c 0x7 0x0>;
	};

	gpio_isp_sda1 {
		gpios = <0x5f 0x0 0x0>;
	};

	gpio_isp_scl1 {
		gpios = <0x5f 0x1 0x0>;
	};

	gpio_mdm_rst {
		gpios = <0x5f 0x2 0x0>;
	};

	gpio_hkadc_ssi {
		gpios;
	};

	gpio_codec_clk {
		gpios;
	};

	gpio_ap_wakeup_mdm {
		gpios = <0x5f 0x3 0x0>;
	};

	gpio_codec_sync {
		gpios = <0x5f 0x4 0x0>;
	};

	gpio_codec_datain {
		gpios = <0x5f 0x5 0x0>;
	};

	gpio_codec_dataout {
		gpios = <0x5f 0x6 0x0>;
	};

	gpio_fm_xclk {
		gpios = <0x5f 0x7 0x0>;
	};

	gpio_fm_xfs {
		gpios = <0x60 0x0 0x0>;
	};

	gpio_fm_di {
		gpios = <0x60 0x1 0x0>;
	};

	gpio_fm_do {
		gpios = <0x60 0x2 0x0>;
	};

	gpio_bt_xclk {
		gpios;
	};

	gpio_bt_xfs {
		gpios;
	};

	gpio_bt_di {
		gpios;
	};

	gpio_bt_do {
		gpios;
	};

	gpio_usim0_clk {
		gpios;
	};

	gpio_usim0_data {
		gpios;
	};

	gpio_usim0_rst {
		gpios;
	};

	gpio_usim1_clk {
		gpios = <0x60 0x3 0x0>;
	};

	gpio_usim1_data {
		gpios = <0x60 0x4 0x0>;
	};

	gpio_usim1_rst {
		gpios = <0x60 0x5 0x0>;
	};

	gpio_unused_004 {
		gpios = <0x60 0x6 0x0>;
	};

	gpio_unused_005 {
		gpios = <0x60 0x7 0x0>;
	};

	gpio_uart0_rxd {
		gpios = <0x61 0x0 0x0>;
	};

	gpio_uart0_txd {
		gpios = <0x61 0x1 0x0>;
	};

	gpio_bt_uart_cts_n {
		gpios = <0x61 0x2 0x0>;
	};

	gpio_bt_uart_rts_n {
		gpios = <0x61 0x3 0x0>;
	};

	gpio_bt_uart_rxd {
		gpios = <0x61 0x4 0x0>;
	};

	gpio_bt_uart_txd {
		gpios = <0x61 0x5 0x0>;
	};

	gpio_gps_uart_cts_n {
		gpios = <0x61 0x6 0x0>;
	};

	gpio_gps_uart_rts_n {
		gpios = <0x61 0x7 0x0>;
	};

	gpio_gps_uart_rxd {
		gpios = <0x62 0x0 0x0>;
	};

	gpio_gps_uart_txd {
		gpios = <0x62 0x1 0x0>;
	};

	gpio_i2c0_scl {
		gpios = <0x62 0x2 0x0>;
	};

	gpio_i2c0_sda {
		gpios = <0x62 0x3 0x0>;
	};

	gpio_i2c1_scl {
		gpios = <0x62 0x4 0x0>;
	};

	gpio_i2c1_sda {
		gpios = <0x62 0x5 0x0>;
	};

	gpio_i2c2_scl {
		gpios = <0x62 0x6 0x0>;
	};

	gpio_i2c2_sda {
		gpios = <0x62 0x7 0x0>;
	};

	gpio_emmc_clk {
		gpios;
	};

	gpio_emmc_cmd {
		gpios;
	};

	gpio_emmc_data0 {
		gpios;
	};

	gpio_emmc_data1 {
		gpios;
	};

	gpio_emmc_data2 {
		gpios;
	};

	gpio_emmc_data3 {
		gpios;
	};

	gpio_emmc_data4 {
		gpios;
	};

	gpio_emmc_data5 {
		gpios;
	};

	gpio_emmc_data6 {
		gpios;
	};

	gpio_emmc_data7 {
		gpios;
	};

	gpio_emmc_rst_n {
		gpios;
	};

	gpio_unused_006 {
		gpios;
	};

	gpio_sdio_clk {
		gpios = <0x63 0x0 0x0>;
	};

	gpio_sdio_cmd {
		gpios = <0x63 0x1 0x0>;
	};

	gpio_sdio_data0 {
		gpios = <0x63 0x2 0x0>;
	};

	gpio_sdio_data1 {
		gpios = <0x63 0x3 0x0>;
	};

	gpio_sdio_data2 {
		gpios = <0x63 0x4 0x0>;
	};

	gpio_sdio_data3 {
		gpios = <0x63 0x5 0x0>;
	};

	gpio_unused_007 {
		gpios;
	};

	gpio_j15_3_0 {
		gpios = <0x64 0x0 0x0>;
	};

	gpio_jtag_sel0 {
		gpios = <0x64 0x1 0x0>;
	};

	gpio_jtag_sel1 {
		gpios = <0x64 0x2 0x0>;
	};

	gpio_lcd_rst_n {
		gpios = <0x64 0x3 0x0>;
	};

	gpio_aux_ssi0 {
		gpios = <0x64 0x4 0x0>;
	};

	gpio_wlan_active_led {
		gpios = <0x64 0x5 0x0>;
	};

	gpio_unused_008 {
		gpios = <0x64 0x6 0x0>;
	};

	gpio_ap_wakeup_bt {
		gpios = <0x64 0x7 0x0>;
	};

	gpio_user_led_1 {
		gpios = <0x65 0x0 0x0>;
	};

	gpio_user_led_2 {
		gpios = <0x65 0x1 0x0>;
	};

	gpio_user_led_3 {
		gpios = <0x65 0x2 0x0>;
	};

	gpio_user_led_4 {
		gpios = <0x65 0x3 0x0>;
	};

	gpio_i2c3_scl {
		gpios = <0x65 0x4 0x0>;
	};

	gpio_i2c3_sda {
		gpios = <0x65 0x5 0x0>;
	};

	gpio_wlan_bt_priority {
		gpios = <0x65 0x6 0x0>;
	};

	gpio_bt_active_led {
		gpios = <0x65 0x7 0x0>;
	};

	gpio_uart3_cts_n {
		gpios = <0x66 0x0 0x0>;
	};

	gpio_uart3_rts_n {
		gpios = <0x66 0x1 0x0>;
	};

	gpio_uart3_rxd {
		gpios = <0x66 0x2 0x0>;
	};

	gpio_uart3_txd {
		gpios = <0x66 0x3 0x0>;
	};

	gpio_aux_ssi1 {
		gpios = <0x66 0x4 0x0>;
	};

	gpio_unused_009 {
		gpios = <0x66 0x5 0x0>;
	};

	gpio_modem_pcm_xclk {
		gpios = <0x66 0x6 0x0>;
	};

	gpio_modem_pcm_xfs {
		gpios = <0x66 0x7 0x0>;
	};

	gpio_spi0_di {
		gpios = <0x2f 0x0 0x0>;
	};

	gpio_spi0_do {
		gpios = <0x2f 0x1 0x0>;
	};

	gpio_spi0_cs_n {
		gpios = <0x2f 0x2 0x0>;
	};

	gpio_spi0_clk {
		gpios = <0x2f 0x3 0x0>;
	};

	gpio_lte_tx_active {
		gpios = <0x2f 0x4 0x0>;
	};

	gpio_lte_rx_active {
		gpios = <0x2f 0x5 0x0>;
	};

	gpio_lcd_id0 {
		gpios = <0x2f 0x6 0x0>;
	};

	gpio_dsi_te0 {
		gpios = <0x2f 0x7 0x0>;
	};

	gpio_lcd_id1 {
		gpios = <0x67 0x0 0x0>;
	};

	gpio_volume1_n {
		gpios = <0x67 0x1 0x0>;
	};

	gpio_uart5_rxd {
		gpios = <0x67 0x2 0x0>;
	};

	gpio_uart5_txd {
		gpios = <0x67 0x3 0x0>;
	};

	gpio_modem_pcm_di {
		gpios = <0x67 0x4 0x0>;
	};

	gpio_modem_pcm_do {
		gpios = <0x67 0x5 0x0>;
	};

	gpio_uart4_rxd {
		gpios = <0x67 0x6 0x0>;
	};

	gpio_uart4_txd {
		gpios = <0x67 0x7 0x0>;
	};

	gpio_ap_wakeup_wl {
		gpios = <0x5d 0x0 0x0>;
	};

	gpio_mdm_pwr_en {
		gpios = <0x5d 0x1 0x0>;
	};

	gpio_tcxo0_afc {
		gpios = <0x63 0x6 0x0>;
	};

	gpio_rf_ssi0 {
		gpios;
	};

	gpio_rf_tcvr_on0 {
		gpios;
	};

	gpio_rf_mipi_clk0 {
		gpios;
	};

	gpio_rf_mipi_data0 {
		gpios = <0x63 0x7 0x0>;
	};

	gpio_flash_mask {
		gpios = <0x68 0x0 0x0>;
	};

	gpio_gps_blanking {
		gpios = <0x68 0x1 0x0>;
	};

	gpio_rf_gpio_2 {
		gpios = <0x68 0x2 0x0>;
	};

	gpio_rf_gpio_3 {
		gpios = <0x68 0x3 0x0>;
	};

	gpio_rf_gpio_4 {
		gpios = <0x68 0x4 0x0>;
	};

	gpio_rf_gpio_5 {
		gpios = <0x68 0x5 0x0>;
	};

	gpio_rf_gpio_6 {
		gpios = <0x68 0x6 0x0>;
	};

	gpio_rf_gpio_7 {
		gpios = <0x68 0x7 0x0>;
	};

	gpio_rf_gpio_8 {
		gpios = <0x69 0x0 0x0>;
	};

	gpio_rf_gpio_9 {
		gpios = <0x69 0x1 0x0>;
	};

	gpio_rf_gpio_10 {
		gpios = <0x69 0x2 0x0>;
	};

	gpio_rf_gpio_11 {
		gpios = <0x69 0x3 0x0>;
	};

	gpio_rf_gpio_12 {
		gpios = <0x69 0x4 0x0>;
	};

	gpio_rf_gpio_13 {
		gpios = <0x69 0x5 0x0>;
	};

	gpio_rf_gpio_14 {
		gpios = <0x69 0x6 0x0>;
	};

	gpio_rf_gpio_15 {
		gpios = <0x69 0x7 0x0>;
	};

	gpio_rf_gpio_16 {
		gpios = <0x6a 0x0 0x0>;
	};

	gpio_rf_gpio_17 {
		gpios = <0x6a 0x1 0x0>;
	};

	gpio_rf_gpio_18 {
		gpios = <0x6a 0x2 0x0>;
	};

	gpio_rf_gpio_19 {
		gpios = <0x6a 0x3 0x0>;
	};

	gpio_rf_gpio_20 {
		gpios = <0x6a 0x4 0x0>;
	};

	gpio_rf_gpio_21 {
		gpios = <0x6a 0x5 0x0>;
	};

	gpio_rf_gpio_22 {
		gpios = <0x6a 0x6 0x0>;
	};

	gpio_rf_gpio_23 {
		gpios = <0x6a 0x7 0x0>;
	};

	gpio_rf_gpio_24 {
		gpios = <0x6b 0x0 0x0>;
	};

	gpio_rf_gpio_25 {
		gpios = <0x6b 0x1 0x0>;
	};

	gpio_rf_gpio_26 {
		gpios = <0x6b 0x2 0x0>;
	};

	gpio_rf_ssi1 {
		gpios = <0x6b 0x3 0x0>;
	};

	gpio_rf_tcvr_on1 {
		gpios = <0x6b 0x4 0x0>;
	};

	gpio_rf_gpio_29 {
		gpios = <0x6b 0x5 0x0>;
	};

	gpio_rf_gpio_30 {
		gpios = <0x6b 0x6 0x0>;
	};

	gpio_apt_pdm0 {
		gpios = <0x6b 0x7 0x0>;
	};

	aliases {
		serial0 = "/soc/uart@f8015000";
		serial1 = "/soc/uart@f7111000";
		serial2 = "/soc/uart@f7112000";
		serial3 = "/soc/uart@f7113000";
		spi0 = "/soc/spi@f7106000";
	};

	chosen {
		stdout-path = "serial3:115200n8";
	};

	fiq-debugger {
		compatible = "android,irq-hi6220-uart";
		reg = <0x0 0xf7113000 0x0 0x1000>;
		interrupts = <0x0 0x27 0x4>;
		interrupt-names = "fiq", "signal";
	};

	uart_overlay@0 {

		fragment@0 {
			target-path = "/soc/uart@f7113000";

			__overlay__ {
				status = "disabled";
			};
		};
	};

	overlay_mgr {
		compatible = "linux,overlay_manager";

		hardware_cfg_innolux_panel {

			overlay_0 {

				fragment@0 {
					target-path = "/soc/dsi@f4107800";

					__overlay__ {
						#address-cells = <0x1>;
						#size-cells = <0x0>;

						panel@1 {
							compatible = "innolux,n070icn-pb1";
							reg = <0x1>;
							power-on-delay = <0x32>;
							reset-delay = <0x64>;
							init-delay = <0x64>;
							panel-width-mm = <0x3a>;
							panel-height-mm = <0x67>;
							pwr-en-gpio = <0x5b 0x1 0x0>;
							bl-en-gpio = <0x5b 0x3 0x0>;
							pwm-gpio = <0x60 0x7 0x0>;

							port {

								endpoint {
									remote-endpoint = <0x6c>;
									linux,phandle = <0x59>;
									phandle = <0x59>;
								};
							};
						};
					};
				};
			};
		};

		hardware_cfg_spidev0 {

			overlay_0 {

				fragment@0 {
					target-path = "/soc/spi@f7106000/spidev@0";

					__overlay__ {
						status = "ok";
					};
				};
			};
		};

		hardware_cfg_cs_sd_qb {

			overlay_0 {

				fragment@0 {
					target-path = "/soc/gpio@f7020000";

					__overlay__ {

						sd_sel {
							gpio-hog;
							gpios = <0x4 0x0>;
							output-high;
							line-name = "gpio_sd_sel";
						};
					};
				};
			};
		};
	};

	memory@0 {
		device_type = "memory";
		reg = <0x0 0x0 0x0 0x5e00000 0x0 0x5f00000 0x0 0x1000 0x0 0x5f02000 0x0 0xefd000 0x0 0x6e00000 0x0 0x60f000 0x0 0x7410000 0x0 0x1aaf0000 0x0 0x22000000 0x0 0x1c000000>;
	};

	pstore@0x21f00000 {
		no-map;
		reg = <0x0 0x21f00000 0x0 0x100000>;
		linux,phandle = <0x6d>;
		phandle = <0x6d>;
	};

	ramoops {
		compatible = "ramoops";
		memory-region = <0x6d>;
		record-size = <0x0 0x20000>;
		console-size = <0x0 0x20000>;
		ftrace-size = <0x0 0x20000>;
	};

	reboot-reason@05f01000 {
		compatible = "linux,reboot-reason-sram";
		reg = <0x0 0x5f01000 0x0 0x4>;
		reason,none = <0x77665501>;
		reason,bootloader = "wfU";
		reason,recovery = <0x77665502>;
		reason,oem = "oem";
	};

	leds {
		compatible = "gpio-leds";

		user_led1 {
			label = "user_led4";
			gpios = <0x65 0x0 0x0>;
			linux,default-trigger = "heartbeat";
		};

		user_led2 {
			label = "user_led3";
			gpios = <0x65 0x1 0x0>;
			linux,default-trigger = "mmc0";
		};

		user_led3 {
			label = "user_led2";
			gpios = <0x65 0x2 0x0>;
			linux,default-trigger = "mmc1";
		};

		user_led4 {
			label = "user_led1";
			gpios = <0x65 0x3 0x0>;
			linux,default-trigger = "cpu0";
		};

		wlan_active_led {
			label = "wifi_active";
			gpios = <0x64 0x5 0x0>;
			linux,default-trigger = "phy0tx";
			default-state = "off";
		};

		bt_active_led {
			label = "bt_active";
			gpios = <0x65 0x7 0x0>;
			linux,default-trigger = "hci0rx";
			default-state = "off";
		};
	};

	kim {
		compatible = "kim";
		pinctrl-names = "default";
		pinctrl-0;
		nshutdown_gpio = <0x1f7>;
		dev_name = "/dev/ttyAMA1";
		flow_cntrl = <0x1>;
		baud_rate = <0x2dc6c0>;
	};

	btwilink {
		compatible = "btwilink";
	};

	pmic@f8000000 {
		compatible = "hisilicon,hi655x-pmic";
		reg = <0x0 0xf8000000 0x0 0x1000>;
		interrupt-controller;
		#interrupt-cells = <0x2>;
		pmic-gpios = <0x36 0x2 0x0>;
		status = "okay";
		linux,phandle = <0x6e>;
		phandle = <0x6e>;

		ponkey@b1 {
			compatible = "hisilicon,hi6552-powerkey";
			interrupt-parent = <0x6e>;
			interrupts = <0x6 0x0 0x5 0x0 0x4 0x0>;
			interrupt-names = "down", "up", "hold 4s";
		};

		regulators {

			LDO2@a21 {
				regulator-name = "LDO2_2V8";
				regulator-min-microvolt = <0x2625a0>;
				regulator-max-microvolt = <0x30d400>;
				regulator-enable-ramp-delay = <0x78>;
			};

			LDO7@a26 {
				regulator-name = "LDO7_SDIO";
				regulator-min-microvolt = <0x1b7740>;
				regulator-max-microvolt = <0x325aa0>;
				regulator-enable-ramp-delay = <0x78>;
				linux,phandle = <0x40>;
				phandle = <0x40>;
			};

			LDO10@a29 {
				regulator-name = "LDO10_2V85";
				regulator-min-microvolt = <0x1b7740>;
				regulator-max-microvolt = <0x2dc6c0>;
				regulator-enable-ramp-delay = <0x168>;
				linux,phandle = <0x41>;
				phandle = <0x41>;
			};

			LDO13@a32 {
				regulator-name = "LDO13_1V8";
				regulator-min-microvolt = <0x186a00>;
				regulator-max-microvolt = <0x1dc130>;
				regulator-enable-ramp-delay = <0x78>;
			};

			LDO14@a33 {
				regulator-name = "LDO14_2V8";
				regulator-min-microvolt = <0x2625a0>;
				regulator-max-microvolt = <0x30d400>;
				regulator-enable-ramp-delay = <0x78>;
			};

			LDO15@a34 {
				regulator-name = "LDO15_1V8";
				regulator-min-microvolt = <0x186a00>;
				regulator-max-microvolt = <0x1dc130>;
				regulator-boot-on;
				regulator-always-on;
				regulator-enable-ramp-delay = <0x78>;
			};

			LDO17@a36 {
				regulator-name = "LDO17_2V5";
				regulator-min-microvolt = <0x2625a0>;
				regulator-max-microvolt = <0x30d400>;
				regulator-enable-ramp-delay = <0x78>;
			};

			LDO19@a38 {
				regulator-name = "LDO19_3V0";
				regulator-min-microvolt = <0x1b7740>;
				regulator-max-microvolt = <0x2dc6c0>;
				regulator-enable-ramp-delay = <0x168>;
				linux,phandle = <0x3b>;
				phandle = <0x3b>;
			};

			LDO21@a40 {
				regulator-name = "LDO21_1V8";
				regulator-min-microvolt = <0x192d50>;
				regulator-max-microvolt = <0x1e8480>;
				regulator-always-on;
				regulator-enable-ramp-delay = <0x78>;
			};

			LDO22@a41 {
				regulator-name = "LDO22_1V2";
				regulator-min-microvolt = <0xdbba0>;
				regulator-max-microvolt = <0x124f80>;
				regulator-boot-on;
				regulator-always-on;
				regulator-enable-ramp-delay = <0x78>;
			};
		};
	};

	firmware {

		optee {
			compatible = "linaro,optee-tz";
			method = "smc";
		};
	};
};
